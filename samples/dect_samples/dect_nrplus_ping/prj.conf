## CMakeLists.txt
```
#
# Copyright (c) 2026 Manulytica Ltd
#

# SPDX-License-Identifier: Apache-2.0

cmake_minimum_required(VERSION 3.20.0)

find_package(Zephyr REQUIRED HINTS $ENV{ZEPHYR_BASE})

project(dect_nrplus_ping)

# MANUALLY add the DECT module
list(APPEND ZEPHYR_EXTRA_MODULES ${CMAKE_CURRENT_SOURCE_DIR}/../../../lib/dect_nrplus)
message(STATUS "Manually adding DECT module: ${CMAKE_CURRENT_SOURCE_DIR}/../../../lib/dect_nrplus")

# Application source
target_sources(app PRIVATE src/main.c)

# That's it! The DECT library is automatically available because:
# 1. It's a Zephyr module (module.yml)
# 2. It exports its headers via target_include_directories(zephyr_interface)
# 3. Zephyr automatically links all enabled modules





# # /* samples/dect_nrplus_ping/CMakeLists.txt */
# # // Overview: A minimal and correct build script for the ping sample. It only compiles main.c and relies on Kconfig to link the DECT NR+ library.

# cmake_minimum_required(VERSION 3.20.0)

# find_package(Zephyr REQUIRED HINTS $ENV{ZEPHYR_BASE})
# project(dect_nrplus_ping_sample)

# # The "app" target is created automatically.
# target_sources(app PRIVATE src/main.c)

# # target_include_directories(app PRIVATE
# # 	../../include
# # 	../../include/mac
# # 	../../include/mocks
# # 	../../tests
# # )

# # The `dect_nrplus_lib` is found and linked automatically by the Zephyr
# # build system because CONFIG_DECT_NRPLUS_STACK=y is set in prj.conf.
# # We only need to link zephyr_interface to satisfy the application's own needs.
# # target_link_libraries(app PRIVATE zephyr_interface)
# target_link_libraries(app PRIVATE dect_nrplus_lib)
```

## sample.yaml
```
#
# Copyright (c) 2026 Manulytica Ltd
#

# /* samples/dect_nrplus_ping/sample.yaml */

sample:
  name: DECT NR+ Ping Sample
  description: Demonstrates end-to-end IPv6 connectivity over the DECT NR+ stack using the network shell.
  platforms:
    - native_sim
```

## prj.conf
```kconfig
#
# Copyright (c) 2026 Manulytica Ltd
#

# /* samples/dect_nrplus_ping/prj.conf */
# // Overview: Base configuration for nRF9161 hardware targets
# // Note: For native_sim, use boards/native_sim_64.conf overlay

# Trim net_buf pool
CONFIG_DECT_DLC_NET_BUF_COUNT=16
# Trim Thread Stacks 
CONFIG_DECT_MAC_THREAD_STACK_SIZE=4096
CONFIG_DECT_DLC_RX_THREAD_STACK_SIZE=512
# CONFIG_DECT_DLC_TX_SERVICE_THREAD_STACK_SIZE=512
# CONFIG_DECT_CVG_RX_THREAD_STACK_SIZE=512
# CONFIG_DECT_CVG_TX_THREAD_STACK_SIZE=512
# CONFIG_DECT_CVG_TX_SERVICE_THREAD_STACK_SIZE=512
# Right-size static arrays
CONFIG_DECT_MAC_PDU_MAX_SIZE=1638



# Networking Stack
CONFIG_NETWORKING=y
# CONFIG_NET_L2_IEEE802154=y
CONFIG_NET_IPV6=y
CONFIG_NET_IPV4=n
CONFIG_NET_6LO=y
CONFIG_NET_6LO_CONTEXT=y
# CONFIG_NET_SHELL=y
# Note: NET_SHELL_PING doesn't exist in Zephyr - use 'net ping' command instead
CONFIG_NET_CONFIG_SETTINGS=y
CONFIG_NET_CONFIG_MY_IPV6_ADDR=""

# Shell Configuration
# CONFIG_SHELL=y
# CONFIG_DECT_MAC_SHELL_ENABLE=y

# DECT NR+ Stack Layers (enabled directly for monolithic build)
CONFIG_DECT_NRPLUS_STACK=y
CONFIG_DECT_MAC_LAYER=y
CONFIG_DECT_DLC_LAYER=y
CONFIG_DECT_CVG_LAYER=y
CONFIG_DECT_CDD_LAYER=y

# Enable the driver's internal threads for real-world operation
CONFIG_DECT_MAC_OWN_THREAD=y
CONFIG_DECT_STACK_HAS_APP_THREADS=y

# Enable Security
# CONFIG_DECT_MAC_SECURITY_ENABLE=y
# CONFIG_DECT_CVG_SECURITY_ENABLE=y

# # Dependencies
# CONFIG_ENTROPY_GENERATOR=y
# CONFIG_ENTROPY_DEVICE_RANDOM_GENERATOR=y

CONFIG_FLASH=y
CONFIG_FLASH_MAP=y
CONFIG_ZMS=y
CONFIG_NVS=y

# Enable Partition Manager, which is required for FIXED_PARTITION_* macros
CONFIG_PARTITION_MANAGER_ENABLED=y


# Logging Configuration
# CONFIG_LOG=y
# CONFIG_LOG_MODE_DEFERRED=y
# CONFIG_LOG_BUFFER_SIZE=1536
# CONFIG_LOG_DEFAULT_LEVEL=2

# CONFIG_DECT_NRPLUS_LOG_LEVEL=3
# CONFIG_DECT_MAC_CORE_LOG_LEVEL=2
# CONFIG_DECT_MAC_SM_PT_LOG_LEVEL=2
# CONFIG_DECT_MAC_SM_FT_LOG_LEVEL=2

# CONFIG_DECT_MAC_CORE_LOG_LEVEL=3
# CONFIG_DECT_MAC_DISPATCHER_LOG_LEVEL=3
# CONFIG_DECT_APP_MAIN_LOG_LEVEL=3


# # /* samples/dect_nrplus_ping/prj.conf */
# # // Overview: Base Kconfig for the ping sample, enabling the full DECT NR+ stack, L2 driver, 6LoWPAN, and network shell.

# # Networking
# CONFIG_NETWORKING=y
# CONFIG_NET_L2_IEEE802154=y
# CONFIG_NET_IPV6=y
# CONFIG_NET_SHELL=y
# CONFIG_NET_SHELL_PING=y
# CONFIG_NET_CONFIG_SETTINGS=y
# CONFIG_NET_CONFIG_MY_IPV6_ADDR="" # We will set this via shell

# # Enable the full DECT NR+ Stack and its layers
# CONFIG_DECT_NRPLUS_STACK=y
# CONFIG_DECT_MAC_LAYER=y
# CONFIG_DECT_DLC_LAYER=y
# CONFIG_DECT_CVG_LAYER=y


# # Enable modem library
# CONFIG_NRF_MODEM_LIB=y
# # Enable DECT PHY in modem library
# CONFIG_NRF_MODEM_DECT_PHY=y
# # Enable Zephyr Modem Storage (ZMS)
# CONFIG_NRF_MODEM_ZMS=y

# # Modem library
# CONFIG_NRF_MODEM_LIB=y
# CONFIG_NRF_MODEM_LIB_ON_FAULT_APPLICATION_SPECIFIC=y
# CONFIG_NRF_MODEM_LIB_SHMEM_RX_SIZE=6144
# CONFIG_NRF_MODEM_LIB_SHMEM_TX_SIZE=15360



# CONFIG_DECT_NRPLUS_RADIO=y
# CONFIG_DECT_MAC_OWN_THREAD=y
# CONFIG_DECT_STACK_HAS_APP_THREADS=y

# # Enable Security (Optional but good for a full test)
# CONFIG_DECT_MAC_SECURITY_ENABLE=y
# CONFIG_DECT_CVG_SECURITY_ENABLE=y

# # Dependencies
# CONFIG_ENTROPY_GENERATOR=y
# # Enable Flash and NVS dependencies
# CONFIG_FLASH=y
# CONFIG_FLASH_MAP=y
# CONFIG_ZMS=y
# CONFIG_NVS=y

# # Enable Partition Manager, which is required for FIXED_PARTITION_* macros
# CONFIG_PARTITION_MANAGER_ENABLED=y

# # Logging
# CONFIG_LOG=y
# CONFIG_LOG_MODE_IMMEDIATE=y
# CONFIG_DECT_NRPLUS_LOG_LEVEL=3
# CONFIG_DECT_MAC_CORE_LOG_LEVEL=2
# CONFIG_DECT_MAC_SM_PT_LOG_LEVEL=2
# CONFIG_DECT_MAC_SM_FT_LOG_LEVEL=2
```

## boards/native_sim_64.conf
```kconfig
#
# Copyright (c) 2026 Manulytica Ltd
#

# System clock for native_sim
CONFIG_SYS_CLOCK_EXISTS=y
# 1μs resolution
CONFIG_SYS_CLOCK_TICKS_PER_SEC=1000000
```

## boards/native_sim_ft.conf
```kconfig
#
# Copyright (c) 2026 Manulytica Ltd
#

# Overlay for native_sim/native/64 with FT role  
# Disables hardware-specific features for simulation

# Disable nRF Modem Library (not available on native_sim)
CONFIG_NRF_MODEM_LIB=n

# Disable hardware security (MBEDTLS requires NRF_SECURITY on nRF platforms)
CONFIG_DECT_MAC_SECURITY_ENABLE=n
CONFIG_DECT_CVG_SECURITY_ENABLE=n

# Disable NVS/Flash (requires real hardware)
CONFIG_NVS=n
CONFIG_ZMS=n
CONFIG_FLASH=n
CONFIG_FLASH_MAP=n
CONFIG_PARTITION_MANAGER_ENABLED=n

# Set FT role
CONFIG_DECT_MAC_ROLE_IS_PT=n
CONFIG_DECT_MAC_ROLE_IS_FT=y  
CONFIG_DECT_MAC_ROLE_IS_FT_PT=n

# Use test random generator for entropy
CONFIG_TEST_RANDOM_GENERATOR=y
```

## boards/native_sim_pt.conf
```kconfig
#
# Copyright (c) 2026 Manulytica Ltd
#

# Overlay for native_sim/native/64 with PT role
# Disables hardware-specific features for simulation

# Disable nRF Modem Library (not available on native_sim)
CONFIG_NRF_MODEM_LIB=n

# Disable hardware security (MBEDTLS requires NRF_SECURITY on nRF platforms)
CONFIG_DECT_MAC_SECURITY_ENABLE=n
CONFIG_DECT_CVG_SECURITY_ENABLE=n

# Disable NVS/Flash (requires real hardware)
CONFIG_NVS=n
CONFIG_ZMS=n
CONFIG_FLASH=n
CONFIG_FLASH_MAP=n
CONFIG_PARTITION_MANAGER_ENABLED=n

# Set PT role
CONFIG_DECT_MAC_ROLE_IS_PT=y
CONFIG_DECT_MAC_ROLE_IS_FT=n
CONFIG_DECT_MAC_ROLE_IS_FT_PT=n

# Use test random generator for entropy
CONFIG_TEST_RANDOM_GENERATOR=y
```

## boards/nrf9161dk_nrf9161_ns_ft.conf
```kconfig
#
# Copyright (c) 2026 Manulytica Ltd
#

# FT role configuration for nrf9161dk hardware
CONFIG_DECT_MAC_ROLE_IS_PT=n
CONFIG_DECT_MAC_ROLE_IS_FT=y
CONFIG_DECT_MAC_ROLE_IS_FT_PT=n

# nRF Modem Library Configuration (nRF9161 hardware only)
CONFIG_NRF_MODEM_LIB=y
CONFIG_MODEM_ANTENNA=n
CONFIG_NRF_MODEM_LINK_BINARY_DECT_PHY=y
CONFIG_HWINFO=y

# Disable LTE to avoid radio coexistence conflicts
CONFIG_LTE_LINK_CONTROL=n

# Disable security for this test
CONFIG_DECT_MAC_SECURITY_ENABLE=n
CONFIG_DECT_CVG_SECURITY_ENABLE=n

# Operating channel: ARFCN 1677 = EU Band 1 base (1657) + channel 21 - 1 = 1677
CONFIG_DECT_MAC_FT_DEFAULT_OPERATING_CHANNEL=21
CONFIG_DECT_MAC_DCS_NUM_CHANNELS_TO_SCAN=1
CONFIG_DECT_MAC_DCS_CHANNEL_LIST="21"
# CONFIG_DECT_MAC_DCS_NUM_CHANNELS_TO_SCAN=5
# CONFIG_DECT_MAC_DCS_CHANNEL_LIST="21,22,23,24,25,26,27,28,29"


# Debugging HardFault: Increase TF-M and Main stack sizes
CONFIG_MAIN_STACK_SIZE=4096
# CONFIG_SYSTEM_WORKQUEUE_STACK_SIZE=4096
# CONFIG_DECT_MAC_THREAD_STACK_SIZE=8192

# Enable Security
# CONFIG_DECT_MAC_SECURITY_ENABLE=y
# CONFIG_DECT_CVG_SECURITY_ENABLE=y

# # Enable entropy driver (required for random number generation)
# CONFIG_ENTROPY_GENERATOR=y
# CONFIG_ENTROPY_DEVICE_RANDOM_GENERATOR=y

# # Enable nordic security backend and PSA APIs
# CONFIG_NRF_SECURITY=y
# CONFIG_MBEDTLS_PSA_CRYPTO_C=y

# CONFIG_MBEDTLS_AES_C=y
# CONFIG_MBEDTLS_LEGACY_CRYPTO_C=y

# CONFIG_PSA_WANT_GENERATE_RANDOM=y
# CONFIG_PSA_WANT_KEY_TYPE_AES=y
# CONFIG_PSA_WANT_ALG_CTR=y
# CONFIG_PSA_WANT_ALG_CMAC=y

# CONFIG_TFM_PROFILE_TYPE_NOT_SET=y

# # Using hardware crypto accelerator
# CONFIG_PSA_CRYPTO_DRIVER_CC3XX=n

# CONFIG_PSA_CRYPTO_DRIVER_OBERON=y

# # # Enable hardware random number generator for nRF91
# # CONFIG_ENTROPY_NRF_RNG=y

# # # Set thresholds for immediate random number generation
# # CONFIG_ENTROPY_NRF_RNG_THR_THRESHOLD=0
# # CONFIG_ENTROPY_NRF_RNG_ISR_THRESHOLD=0

# Enable logging
CONFIG_LOG=y
CONFIG_LOG_BACKEND_RTT=y
CONFIG_USE_SEGGER_RTT=y
CONFIG_RTT_CONSOLE=y
CONFIG_CONSOLE=y
CONFIG_PRINTK=y

CONFIG_LOG_BACKEND_RTT=y
CONFIG_LOG_BACKEND_UART=n

# Use deferred logging to prevent blocking during early init
CONFIG_LOG_MODE_DEFERRED=y
CONFIG_LOG_BUFFER_SIZE=1536
CONFIG_LOG_DEFAULT_LEVEL=2

# CONFIG_DECT_MAC_CORE_LOG_LEVEL=2
# CONFIG_DECT_MAC_DISPATCHER_LOG_LEVEL=2
# CONFIG_DECT_APP_MAIN_LOG_LEVEL=2
CONFIG_DECT_MAC_PHY_IF_LOG_LEVEL=3
CONFIG_DECT_MAC_PHY_CTRL_LOG_LEVEL=3
CONFIG_DECT_MAC_DATA_PATH_LOG_LEVEL=3
```

## boards/nrf9161dk_nrf9161_ns_pt.conf
```kconfig
#
# Copyright (c) 2026 Manulytica Ltd
#

# PT role configuration for nrf9161dk hardware
CONFIG_DECT_MAC_ROLE_IS_PT=y
CONFIG_DECT_MAC_ROLE_IS_FT=n
CONFIG_DECT_MAC_ROLE_IS_FT_PT=n

# nRF Modem Library Configuration (nRF9161 hardware only)
CONFIG_NRF_MODEM_LIB=y
CONFIG_MODEM_ANTENNA=n
CONFIG_NRF_MODEM_LINK_BINARY_DECT_PHY=y
CONFIG_HWINFO=y

# # CONFIG_NRF_MODEM_LIB_ON_FAULT_APPLICATION_SPECIFIC=y
# CONFIG_NRF_MODEM_LIB_SHMEM_RX_SIZE=6144
# CONFIG_NRF_MODEM_LIB_SHMEM_TX_SIZE=15360

# Disable LTE to avoid radio coexistence conflicts
CONFIG_LTE_LINK_CONTROL=n

# Disable security for this test
CONFIG_DECT_MAC_SECURITY_ENABLE=n
CONFIG_DECT_CVG_SECURITY_ENABLE=n

# Operating channel: ARFCN 1677 = EU Band 1 base (1657) + channel 21 - 1 = 1677
CONFIG_DECT_MAC_FT_DEFAULT_OPERATING_CHANNEL=21

# Debugging HardFault: Increase TF-M and Main stack sizes
CONFIG_MAIN_STACK_SIZE=4096
# CONFIG_SYSTEM_WORKQUEUE_STACK_SIZE=4096
# CONFIG_DECT_MAC_THREAD_STACK_SIZE=8192

# Enable Security
# CONFIG_DECT_MAC_SECURITY_ENABLE=y
# CONFIG_DECT_CVG_SECURITY_ENABLE=y

# # Enable entropy driver (required for random number generation)
# CONFIG_ENTROPY_GENERATOR=y
# CONFIG_ENTROPY_DEVICE_RANDOM_GENERATOR=y

# # Enable nordic security backend and PSA APIs
# CONFIG_NRF_SECURITY=y
# CONFIG_MBEDTLS_PSA_CRYPTO_C=y

# CONFIG_MBEDTLS_AES_C=y
# CONFIG_MBEDTLS_LEGACY_CRYPTO_C=y

# CONFIG_PSA_WANT_GENERATE_RANDOM=y
# CONFIG_PSA_WANT_KEY_TYPE_AES=y
# CONFIG_PSA_WANT_ALG_CTR=y
# CONFIG_PSA_WANT_ALG_CMAC=y

# CONFIG_TFM_PROFILE_TYPE_NOT_SET=y

# # Using hardware crypto accelerator
# CONFIG_PSA_CRYPTO_DRIVER_CC3XX=n

# CONFIG_PSA_CRYPTO_DRIVER_OBERON=y

# # # Enable hardware random number generator for nRF91
# # CONFIG_ENTROPY_NRF_RNG=y

# # # Set thresholds for immediate random number generation
# # CONFIG_ENTROPY_NRF_RNG_THR_THRESHOLD=0
# # CONFIG_ENTROPY_NRF_RNG_ISR_THRESHOLD=0


# Enable logging
CONFIG_LOG=y
CONFIG_LOG_BACKEND_RTT=y
CONFIG_USE_SEGGER_RTT=y
CONFIG_RTT_CONSOLE=y
CONFIG_CONSOLE=y
CONFIG_PRINTK=y

CONFIG_LOG_BACKEND_RTT=y
CONFIG_LOG_BACKEND_UART=n

# Use deferred logging to prevent blocking during early init
CONFIG_LOG_MODE_DEFERRED=y
CONFIG_LOG_BUFFER_SIZE=1536
CONFIG_LOG_DEFAULT_LEVEL=2

# CONFIG_DECT_MAC_CORE_LOG_LEVEL=3
# CONFIG_DECT_MAC_DISPATCHER_LOG_LEVEL=3
# CONFIG_DECT_APP_MAIN_LOG_LEVEL=3
CONFIG_DECT_MAC_PHY_IF_LOG_LEVEL=3
CONFIG_DECT_MAC_PHY_CTRL_LOG_LEVEL=3
CONFIG_DECT_MAC_DATA_PATH_LOG_LEVEL=3
```

## src/main.c
```c
/*
 * Copyright (c) 2026 Manulytica Ltd
 */

/* samples/dect_nrplus_ping/src/main.c */
// Overview: The main application entry point for the ping sample. It uses only the clean, public stack API to initialize and start the DECT NR+ stack, then yields to the network shell.
#include <zephyr/kernel.h>
#include <zephyr/logging/log.h>
#include <zephyr/net/net_if.h>
#include <zephyr/net/net_ip.h>


/* This is the ONLY header needed to interact with the DECT NR+ stack */
#include <dect_stack_api.h>

#if !defined(CONFIG_BOARD_NATIVE_SIM)
#include <nrf_modem_dect_phy.h>
#include <modem/nrf_modem_lib.h>
#endif

LOG_MODULE_REGISTER(dect_ping_sample, LOG_LEVEL_INF);

static void stack_state_cb(dect_mac_public_state_t new_state)
{
	if (new_state == MAC_STATE_PUB_ASSOCIATED) {
		LOG_INF("DECT NR+ Link is UP. Network interface is ready.");
		LOG_INF("Use the 'net' shell command to configure IP addresses and ping.");
	} else {
		LOG_WRN("DECT NR+ Link is NOT ASSOCIATED (State: %d).", new_state);
	}
}

int main(void)
{
	LOG_INF("Starting DECT NR+ Ping Sample...");
	printk("Starting DECT NR+ Ping Sample...");
	
	int err;

#if defined(CONFIG_NRF_MODEM_LIB)
	printk("*********************************************STARTING MODEM LIB************************************\n");
	err = nrf_modem_lib_init();
	if (err) {
		LOG_ERR("[PHY_IF] Modem init failed, err %d", err);
		return err;
	}
	LOG_INF("[PHY_IF] nRF Modem Library initialized.");
#endif /*  */



	err = dect_stack_init();
	if (err) {
		LOG_ERR("Failed to initialize DECT NR+ stack: %d", err);
		return 0;
	}

	dect_stack_register_state_change_cb(stack_state_cb);

#if IS_ENABLED(CONFIG_DECT_MAC_ROLE_IS_FT)
	struct in6_addr ft_prefix;

	err = net_addr_pton(AF_INET6, "2001:db8:cafe::", &ft_prefix);
	if (err) {
		LOG_ERR("Invalid prefix string");
		printk("Invalid prefix string");
		return 0;
	}

	// /* dect_cdd_ft_build_own_config is a public API function included via dect_stack_api.h */
	// err = dect_cdd_ft_build_own_config(&ft_prefix);
	// if (err) {
	// 	LOG_ERR("FT failed to build CDD config: %d", err);
	// 	printk("FT failed to build CDD config: %d", err);
	// 	return 0;
	// }
#endif

	dect_stack_start();

	/* The main thread can now sleep, as all operations are handled by the
	 * DECT stack threads and the Zephyr network shell.
	 */
	return 0;
}
```
