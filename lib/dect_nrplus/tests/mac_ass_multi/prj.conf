## CMakeLists.txt
```
# /* tests/mac_ass/CMakeLists.txt */
# // Overview: Corrects the test build script by removing all library source files. The test now only compiles its own main function and the mock PHY, and relies on Kconfig to link the main `dect_nrplus_driver` library.
cmake_minimum_required(VERSION 3.20.0)

find_package(Zephyr REQUIRED HINTS $ENV{ZEPHYR_BASE})
project(dect_mac_association_test)

# The "app" target is created automatically for a Zephyr application.

# Add only the source files specific to this test:
# - The test's main entry point (containing the Ztest suite)
# - The mock PHY that replaces the real one's functions at link time.
target_sources(app PRIVATE
    src/main.c
    # The mock PHY that replaces the real one
    # # ../../mac/mock_nrf_modem_dect_phy.c
    # The virtual timer simulation clock
    ../../tests/utils/virtual_timer.c
    # The new shared test harness helper
    ../../tests/utils/test_harness_helpers.c    
    )

    
# Add the necessary include directories so the compiler can find headers
# like <mac/dect_mac_core.h> and <mocks/mock_nrf_modem_dect_phy.h>.
target_include_directories(app PRIVATE
    ../../include
    ../../include/mac
    ../../include/mocks
    ../../tests
)

# NOTE: target_link_libraries is NOT needed here.
# Because prj.conf sets CONFIG_DECT_NRPLUS_STACK=y, the build system
# automatically finds and links the 'dect_nrplus_driver' library.
```

## prj.conf
```kconfig
#/* tests/mac_association/prj.conf */
#// Overview: Kconfig for the MAC association test.

# Enable Ztest framework
CONFIG_ZTEST=y
CONFIG_TEST_USERSPACE=n
CONFIG_DECT_MAC_SEND_MOCK_API=y

# # System clock for native_sim
# CONFIG_SYS_CLOCK_EXISTS=y
# # 1μs resolution
# CONFIG_SYS_CLOCK_TICKS_PER_SEC=1000000

# Enable the DECT NR+ Stack and its layers
# Disable the library build; the test compiles sources directly.
CONFIG_DECT_NRPLUS_STACK=y
CONFIG_DECT_MAC_LAYER=y
CONFIG_DECT_DLC_LAYER=n
CONFIG_DECT_CVG_LAYER=n

# Instruct the build to exclude hardware-specific code (like PM) for this test
# CONFIG_DECT_MAC_USE_MOCK_PHY=y

# Disable security for this test
CONFIG_DECT_MAC_SECURITY_ENABLE=n
CONFIG_DECT_CVG_SECURITY_ENABLE=n 
# Disable the MAC's internal thread so the test can drive it manually
CONFIG_DECT_MAC_OWN_THREAD=n
# Disable the CVG/DLC data threads for this MAC-only test to prevent deadlocks
# CONFIG_DECT_STACK_HAS_APP_THREADS=n

# Enable the core Entropy subsystem, which provides the random number generator API
CONFIG_ENTROPY_GENERATOR=y

# CONFIG_DECT_MAC_FT_COUNT_TO_TRIGGER_CODE=7
CONFIG_DECT_MAC_FT_MAX_ASSOCIATED_PTS=32

CONFIG_DECT_MAC_PT_MOBILITY_ENABLE=n
CONFIG_DECT_MAC_PT_MOBILITY_SCAN_MS=2000
CONFIG_DECT_MAC_FT_DEFAULT_OPERATING_CHANNEL=2


# Enable Flash and NVS dependencies for MAC context saving
CONFIG_FLASH=y
CONFIG_FLASH_MAP=y
# CONFIG_FLASH_SIMULATOR=y
CONFIG_ZMS=y

# Enable logging for debugging
CONFIG_LOG=y
CONFIG_DECT_MAC_CORE_LOG_LEVEL=3
CONFIG_DECT_MAC_SM_PT_LOG_LEVEL=3
CONFIG_DECT_MAC_SM_FT_LOG_LEVEL=3
CONFIG_DECT_MAC_PDU_LOG_LEVEL=3
CONFIG_DECT_MAC_PHY_IF_LOG_LEVEL=3
```

## boards/native_sim_64.conf
```kconfig
# /* boards/native_sim_64.conf */
CONFIG_TEST_USERSPACE=n
CONFIG_DECT_MAC_SEND_MOCK_API=y

# System clock for native_sim
CONFIG_SYS_CLOCK_EXISTS=y
CONFIG_SYS_CLOCK_TICKS_PER_SEC=10000

# Disable Nordic-specific Hardware Security for the simulator
CONFIG_NRF_SECURITY=n

# Entropy & Random Number Generator (Required by native_sim)
CONFIG_ENTROPY_GENERATOR=y
CONFIG_TEST_RANDOM_GENERATOR=y
```

## boards/nrf9161dk_nrf9161_ns.conf
```kconfig
# /* lib/dect_nrplus/tests/mac_ass/boards/nrf9161dk_nrf9161_ns.conf */
# Use the Nordic Security backend, which enables the CryptoCell hardware
# and satisfies all PSA API dependencies selected by the library Kconfig.
CONFIG_NRF_SECURITY=y

# Enable RTT for logging on the DK
CONFIG_USE_SEGGER_RTT=y
CONFIG_RTT_CONSOLE=y

# Enable Flash and NVS dependencies
CONFIG_FLASH=y
CONFIG_FLASH_MAP=y
CONFIG_NVS=y

# Enable Partition Manager, which is required for FIXED_PARTITION_* macros
CONFIG_PARTITION_MANAGER_ENABLED=y


# CONFIG_CLOCK_CONTROL_NRF=y
# CONFIG_SOC_FAMILY_NRF=y
# CONFIG_CORTEX_M_SYSTICK=y  # For ARM Cortex-Mcd ..
```

## src/main.c
```c
/*
 * Copyright (c) 2026 Manulytica Ltd
 */

/* working versions 1*/
/* lib/dect_nrplus/tests/mac_ass/src/main.c */
// Overview: The complete, corrected test suite for MAC association. This version includes all functional tests (association, rejection, keep-alive, release), all of which are now compatible with the robust, kernel-time-based simulation harness.
#include <zephyr/ztest.h>
#include <zephyr/sys/byteorder.h>
#include <string.h>
#include <zephyr/kernel.h>

#include <mac/dect_mac.h>
#include <mac/dect_mac_context.h>
#include <mac/dect_mac_core.h>
#include <mac/dect_mac_pdu.h>
#include <mac/dect_mac_phy_if.h>
#include <mac/dect_mac_main_dispatcher.h>
#include <mocks/mock_nrf_modem_dect_phy.h>
#include "../../tests/utils/test_harness_helpers.h"
#include <zephyr/drivers/timer/system_timer.h> 

/* --- Test Globals --- */
uint8_t g_last_tx_pdu_capture[CONFIG_DECT_MAC_PDU_MAX_SIZE];
uint16_t g_last_tx_pdu_len_capture = 0;

/* This test works but the number of nodes is limited, be careful due to buffers and memory*/
#define NUM_FTS 4
#define NUM_PTS 15

static dect_mac_context_t g_mac_ctx_pt[NUM_PTS];
static dect_mac_context_t g_mac_ctx_ft[NUM_FTS];
static mock_phy_context_t g_phy_ctx_pt[NUM_PTS];
static mock_phy_context_t g_phy_ctx_ft[NUM_FTS];

/* Peer lists: For simplicity, every node can hear every other node of the opposite role. */
static mock_phy_context_t *pt_peers[NUM_FTS];
static mock_phy_context_t *ft_peers[NUM_PTS];


#if IS_ENABLED(CONFIG_ZTEST)
extern int dect_mac_test_inject_event_internal(struct dect_mac_context *ctx,
					       dect_mac_event_type_t event_type, int timer_id);
#endif


// {
//     uint64_t current_time_us = k_ticks_to_us_floor64(k_uptime_ticks());
//     printk("[DEBUG_TIME] %s: Current time = %llu us\n", location, current_time_us);
// }


// static void dump_mac_context_state(const char *label, dect_mac_context_t *ctx)
// {
// 	printk("\n--- CONTEXT DUMP: %s (Context @ %p, Role: %s) ---\n",
// 	       label, (void *)ctx, (ctx->role == MAC_ROLE_PT ? "PT" : "FT"));
// 	printk("  - State: %s (%d)\n", dect_mac_state_to_str(ctx->state), ctx->state);
// 	printk("  - Pending Op: %s (Handle: %u)\n",
// 	       dect_pending_op_to_str(ctx->pending_op_type), ctx->pending_op_handle);

// 	if (ctx->role == MAC_ROLE_PT) {
// 		printk("  - PT Keep-Alive Timer Status: %u (Remaining: %u)\n",
// 		       k_timer_status_get(&ctx->role_ctx.pt.keep_alive_timer),
// 		       k_timer_remaining_get(&ctx->role_ctx.pt.keep_alive_timer));
// 		printk("  - PT Mobility Timer Status: %u (Remaining: %u)\n",
// 		       k_timer_status_get(&ctx->role_ctx.pt.mobility_scan_timer),
// 		       k_timer_remaining_get(&ctx->role_ctx.pt.mobility_scan_timer));
// 		printk("  - PT Associated FT is_valid: %d\n",
// 		       ctx->role_ctx.pt.associated_ft.is_valid);
// 	} else {
// 		printk("  - FT Beacon Timer Status: %u (Remaining: %u)\n",
// 		       k_timer_status_get(&ctx->role_ctx.ft.beacon_timer),
// 		       k_timer_remaining_get(&ctx->role_ctx.ft.beacon_timer));
// 		printk("  - FT Connected Peers:\n");
// 		for (int i = 0; i < MAX_PEERS_PER_FT; i++) {
// 			if (ctx->role_ctx.ft.connected_pts[i].is_valid) {
// 				printk("    - Slot %d: VALID, ShortID: 0x%04X\n", i,
// 				       ctx->role_ctx.ft.connected_pts[i].short_rd_id);
// 			}
// 		}
// 	}
// 	printk("--- END CONTEXT DUMP ---\n");
// }



static void process_all_mac_events(void)
{
	struct dect_mac_event_msg msg;
	while (k_msgq_get(&mac_event_msgq, &msg, K_NO_WAIT) == 0) {
		zassert_not_null(msg.ctx, "Event in queue has NULL context!");
        
        mock_phy_context_t *msg_phy_ctx = NULL;
        for (int i=0; i<NUM_FTS; i++) {
            if (msg.ctx == &g_mac_ctx_ft[i]) msg_phy_ctx = &g_phy_ctx_ft[i];
        }
        for (int i=0; i<NUM_PTS; i++) {
            if (msg.ctx == &g_mac_ctx_pt[i]) msg_phy_ctx = &g_phy_ctx_pt[i];
        }
		mock_phy_set_active_context(msg_phy_ctx);
		dect_mac_test_set_active_context(msg.ctx);
		dect_mac_event_dispatch(&msg);
	}

    for (int i=0; i<NUM_FTS; i++) {
	    dect_mac_test_set_active_context(&g_mac_ctx_ft[i]);
	    dect_mac_service();
    }
    for (int i=0; i<NUM_PTS; i++) {
	    dect_mac_test_set_active_context(&g_mac_ctx_pt[i]);
	    dect_mac_service();
    }
}


static bool run_simulation_until(uint64_t timeout_us, bool (*break_cond_func)(void))
{
    uint64_t end_time_us = k_ticks_to_us_floor64(k_uptime_ticks()) + timeout_us;

    uint32_t iteration_count = 0;
    uint32_t stall_count = 0;
    uint64_t last_time_us = k_ticks_to_us_floor64(k_uptime_ticks());
    
    printk("[SIMULATION] Starting simulation. End time: %llu us, Timeout: %llu us\n",
           end_time_us, timeout_us);
    
    while (k_ticks_to_us_floor64(k_uptime_ticks()) < end_time_us) {
        iteration_count++;
        
        /* Safety check: prevent infinite loops */
        if (iteration_count > 10000) {
            printk("[SIMULATION] Maximum iterations (%u) reached, breaking\n", iteration_count);
            break;
        }
        
        /* Check if we're stuck at the same time */
        uint64_t now_us = k_ticks_to_us_floor64(k_uptime_ticks());
        if (now_us == last_time_us) {
            stall_count++;
            if (stall_count > 10) {
                printk("[SIMULATION] Stuck at same time for %u iterations, forcing advance\n", stall_count);
                // k_sleep(K_MSEC(1));  // Force 1ms advance
                k_usleep(1);
                stall_count = 0;
            }
        } else {
            stall_count = 0;
        }
        last_time_us = now_us;
        
        /* Check break condition */
        if (break_cond_func && break_cond_func()) {
            printk("[SIMULATION] Break condition met at iteration %u\n", iteration_count);
            return true;
        }
        
        mock_phy_context_t *all_phys[NUM_PTS + NUM_FTS];
        for (int i=0; i<NUM_PTS; i++) all_phys[i] = &g_phy_ctx_pt[i];
        for (int i=0; i<NUM_FTS; i++) all_phys[NUM_PTS + i] = &g_phy_ctx_ft[i];
        
        uint64_t next_phy_event_time = mock_phy_get_next_event_time(all_phys, NUM_PTS + NUM_FTS);
        
        /* Step 2: Set a simulation heartbeat (max 5ms jump) to handle hidden timers (DLC/CVG) */
        uint64_t next_timer_expiry_us = now_us + 5000;
        
        uint64_t next_event_time = MIN(next_phy_event_time, next_timer_expiry_us);
        uint64_t time_to_advance_us;
        
        /* Debug output */
printk("[SIM_DEBUG] Iteration %u: now=%llu, next_phy=%llu, next_timer=%llu, next_event=%llu\n",
               iteration_count, now_us, next_phy_event_time, next_timer_expiry_us, next_event_time);
        
        /* Calculate time to advance */
        if (next_event_time == UINT64_MAX || next_event_time > end_time_us) {
            /* No more events or beyond end time - advance to end */
            // time_to_advance_us = end_time_us - now_us;
            time_to_advance_us = MIN(1000, end_time_us - now_us);
            printk("  Advancing to end time: %llu us\n", time_to_advance_us);
        } else if (next_event_time > now_us) {
            /* Event in future - advance to event time */
            time_to_advance_us = next_event_time - now_us;
            printk("  Advancing to next event: %llu us\n", time_to_advance_us);
        } else {
            /* Event now or in past - advance minimally to make progress */
            time_to_advance_us = 1;  /* Minimum 1us advance */
            printk("  Event now/past, advancing minimally: %llu us\n", time_to_advance_us);
        }
        // if (next_event_time == UINT64_MAX) {
        //     /* No future events scheduled. Advance by a fixed tick or until the timeout. */
        //     time_to_advance_us = MIN(10000, end_time_us - now_us); /* 10ms tick */
        //     printk("   - UINT64_MAX advancing 10ms tick */ \n");
        // } else if (next_event_time > end_time_us) {
        //     /* Next event is past our timeout. Advance until the timeout. */
        //     time_to_advance_us = end_time_us - now_us;
        //     printk("  Advancing to end time: %llu us\n", time_to_advance_us);
        // } else if (next_event_time > now_us) {
        //     /* Event is in the future. Advance to that time. */
        //     time_to_advance_us = next_event_time - now_us;
        //     printk("  Advancing to next event: %llu us\n", time_to_advance_us);
        // } else {
        //     /* Event is now or in the past. Advance by a minimal amount to make progress. */
        //     time_to_advance_us = 1;
        //     printk("  Event now/past, advancing minimally: %llu us\n", time_to_advance_us);
        // }

        /* Ensure we don't advance past end time */
        if (time_to_advance_us > 0 && now_us + time_to_advance_us > end_time_us) {
            time_to_advance_us = end_time_us - now_us;
            printk("  Adjusted to not exceed end time: %llu us\n", time_to_advance_us);
        }
        
        /* Advance time using busy wait for small intervals */
        if (time_to_advance_us > 0) {
            if (time_to_advance_us <= 1500) {
                /* Use busy wait for small intervals to avoid scheduler issues */
                printk("[SIMULATION] Busy wait for %llu us\n", time_to_advance_us);
                k_busy_wait(time_to_advance_us);
            } else {
                /* Use usleep for larger intervals */
                printk("[SIMULATION] Usleep for %llu us\n", time_to_advance_us);
                k_sleep(K_USEC(time_to_advance_us));
                // k_usleep(time_to_advance_us);
            }
        }
 
        /* Process events at current time */
        uint64_t current_time_us = k_ticks_to_us_floor64(k_uptime_ticks());
        printk("  Processing events at time: %llu us\n", current_time_us);
        
        for (int i=0; i<NUM_PTS; i++) mock_phy_process_events(&g_phy_ctx_pt[i], current_time_us);
        for (int i=0; i<NUM_FTS; i++) mock_phy_process_events(&g_phy_ctx_ft[i], current_time_us);
        process_all_mac_events();
        
        /* Break if no more events and we've reached the end */
        if (next_event_time == UINT64_MAX && 
            k_ticks_to_us_floor64(k_uptime_ticks()) >= end_time_us) {
            printk("[SIMULATION] No more events and end time reached, breaking\n");
            break;
        }
        
        printk("  --- End iteration %u ---\n", iteration_count);
    }
    
    printk("[SIMULATION] Ended after %u iterations. Final time: %llu us\n",
           iteration_count, k_ticks_to_us_floor64(k_uptime_ticks()));
    
    return (break_cond_func && break_cond_func());
}

static bool are_all_fts_beaconing(void) {
    for (int i=0; i<NUM_FTS; i++) {
        if (g_mac_ctx_ft[i].state != MAC_STATE_FT_BEACONING) return false;
    }
    return true;
}

static bool are_all_pts_associated(void) {
    for (int i=0; i<NUM_PTS; i++) {
        printk("  - PT[%d] (ShortID: 0x%04X) with FT ShortID: 0x%04X\n",
               i,
               g_mac_ctx_pt[i].own_short_rd_id,
               g_mac_ctx_pt[i].role_ctx.pt.associated_ft.short_rd_id);

        if (g_mac_ctx_pt[i].state != MAC_STATE_ASSOCIATED) return false;
    }
    return true;
}


static void *dect_mac_assoc_setup(void)
{
	zassert_ok(dect_mac_init(NULL, NULL), "dect_mac_init failed");
	return NULL;
}

static void dect_mac_assoc_before(void *fixture)
{
    ARG_UNUSED(fixture);
    int err;

    /* Reset shared resources to ensure test isolation */
	dect_mac_phy_if_reset_handle_map();

    for (int i=0; i<NUM_FTS; i++) pt_peers[i] = &g_phy_ctx_ft[i];
    for (int i=0; i<NUM_PTS; i++) ft_peers[i] = &g_phy_ctx_pt[i];

    /* Complete memory reset of all contexts */
    memset(g_mac_ctx_pt, 0, sizeof(g_mac_ctx_pt));
    memset(g_mac_ctx_ft, 0, sizeof(g_mac_ctx_ft));
    
    for (int i=0; i<NUM_PTS; i++) {
        mock_phy_complete_reset(&g_phy_ctx_pt[i]);
        mock_phy_init_context(&g_phy_ctx_pt[i], &g_mac_ctx_pt[i], pt_peers, NUM_FTS);
        k_timer_stop(&g_mac_ctx_pt[i].role_ctx.pt.keep_alive_timer);
        k_timer_init(&g_mac_ctx_pt[i].role_ctx.pt.keep_alive_timer, NULL, NULL);
        k_timer_stop(&g_mac_ctx_pt[i].role_ctx.pt.mobility_scan_timer);
        // k_timer_init(&g_mac_ctx_pt[i].role_ctx.pt.mobility_scan_timer, NULL, NULL);
    }
    
    for (int i=0; i<NUM_FTS; i++) {
        mock_phy_complete_reset(&g_phy_ctx_ft[i]);
        mock_phy_init_context(&g_phy_ctx_ft[i], &g_mac_ctx_ft[i], ft_peers, NUM_PTS);
        k_timer_stop(&g_mac_ctx_ft[i].role_ctx.ft.beacon_timer);
        k_timer_init(&g_mac_ctx_ft[i].role_ctx.ft.beacon_timer, NULL, NULL);
    }
    
    struct dect_mac_event_msg msg;
    while (k_msgq_get(&mac_event_msgq, &msg, K_NO_WAIT) == 0) { }

    for (int i=0; i<NUM_FTS; i++) {
        /* Configure FT timing BEFORE init so it is reflected in advertised RACH IEs */
        g_mac_ctx_ft[i].config.ft_cluster_beacon_period_ms = 1000;
        g_mac_ctx_ft[i].config.keep_alive_period_ms = 1000;
        g_mac_ctx_ft[i].config.rach_response_window_ms = 200;

        /* Initialize MAC cores */
        dect_mac_test_set_active_context(&g_mac_ctx_ft[i]);
        mock_phy_set_active_context(&g_phy_ctx_ft[i]);
        err = dect_mac_core_init(MAC_ROLE_FT, 0x11223344 + i);
        zassert_ok(err, "FT%d dect_mac_core_init failed", i);

        /* Optional: give each FT a different operating channel to avoid immediate collisions, though ETSI handles collisions. */
        // g_mac_ctx_ft[i].role_ctx.ft.operating_carrier = 2 + i; 
	    g_mac_ctx_ft[i].network_id_32bit = 0xAA000000;
    }

    for (int i=0; i<NUM_PTS; i++) {
        dect_mac_test_set_active_context(&g_mac_ctx_pt[i]);
        mock_phy_set_active_context(&g_phy_ctx_pt[i]);
        err = dect_mac_core_init(MAC_ROLE_PT, 0xAABBCC00 + i);
        zassert_ok(err, "PT dect_mac_core_init failed");
        g_mac_ctx_pt[i].network_id_32bit = 0xAA000000;
        g_mac_ctx_pt[i].config.keep_alive_period_ms = 100000;
        g_mac_ctx_pt[i].config.ft_cluster_beacon_period_ms = 5000;
        
        /* Initialize the RSSI limits correctly so that associations aren't immediately dropped */
        // g_mac_ctx_pt[i].role_ctx.pt.associated_ft.rssi_2 = -50;
    }
    
    dect_mac_register_state_change_cb(test_mac_state_change_cb);    
}

static void dect_mac_assoc_after(void *fixture)
{
    ARG_UNUSED(fixture);

    for (int i=0; i<NUM_PTS; i++) {
        k_timer_stop(&g_mac_ctx_pt[i].role_ctx.pt.keep_alive_timer);
        k_timer_stop(&g_mac_ctx_pt[i].role_ctx.pt.mobility_scan_timer);
        if (g_phy_ctx_pt[i].state == PHY_STATE_ACTIVE) nrf_modem_dect_phy_deactivate();
        mock_phy_complete_reset(&g_phy_ctx_pt[i]);
    }
    for (int i=0; i<NUM_FTS; i++) {
        k_timer_stop(&g_mac_ctx_ft[i].role_ctx.ft.beacon_timer);
        if (g_phy_ctx_ft[i].state == PHY_STATE_ACTIVE) nrf_modem_dect_phy_deactivate();
        mock_phy_complete_reset(&g_phy_ctx_ft[i]);
    }
    
    /* Clear any remaining events */
    struct dect_mac_event_msg msg;
    int drained = 0;
    while (k_msgq_get(&mac_event_msgq, &msg, K_NO_WAIT) == 0) {
        drained++;
    }
    if (drained > 0) {
        printk("[TEST_CLEANUP] Drained %d remaining events\n", drained);
    }
    
    /* Clear global test state */
    g_last_tx_pdu_len_capture = 0;
    memset(g_last_tx_pdu_capture, 0, sizeof(g_last_tx_pdu_capture));
}

/* --- Test Cases --- */



ZTEST(dect_mac_assoc, test_pt_ft_association)
{
    printk("\n--- RUNNING TEST: %s ---\n", __func__);

    debug_operation_handle_map("BEFORE_TEST");

    /* Get current time at test start */
    uint64_t test_start_time = k_ticks_to_us_floor64(k_uptime_ticks());
    printk("[TEST] Test starting at time: %llu us\n", test_start_time);

	/* 1. Start FTs and run simulation until they're all beaconing */
    printk("\n\n[TEST] 1. Starting %d FTs and waiting for beaconing\n", NUM_FTS);
    for (int i=0; i<NUM_FTS; i++) {
	    dect_mac_test_set_active_context(&g_mac_ctx_ft[i]);
	    mock_phy_set_active_context(&g_phy_ctx_ft[i]);
	    nrf_modem_dect_phy_activate(NRF_MODEM_DECT_PHY_RADIO_MODE_LOW_LATENCY);
	    dect_mac_start();
        process_all_mac_events();
        run_simulation_until(20000, NULL);
        // dect_mac_test_inject_event_internal(&g_mac_ctx_ft[i], MAC_EVENT_TIMER_EXPIRED_BEACON, 0);
    }
	process_all_mac_events();
	zassert_true(run_simulation_until(2000000, are_all_fts_beaconing), "All FTs never started beaconing");


    /* Run simulation until it's time to start PT */
    run_simulation_until(20000, NULL);

	/* 3. Start PTs and run simulation until they're all associated */
    printk("\n\n[TEST] 3. Starting %d PTs and waiting for association\n", NUM_PTS);
    for (int i=0; i<NUM_PTS; i++) {
        printk("  - Starting PT[%d] (LongID: 0xAABBCC%02X) after small delay...\n", i, i);
        
        /* Stagger by 10ms (1 frame) to reduce RACH collisions */
        run_simulation_until(10000, NULL);
        
	    dect_mac_test_set_active_context(&g_mac_ctx_pt[i]);
	    mock_phy_set_active_context(&g_phy_ctx_pt[i]);
	    nrf_modem_dect_phy_activate(NRF_MODEM_DECT_PHY_RADIO_MODE_LOW_LATENCY);
	    dect_mac_start();
        
        /* Process events immediately */
        process_all_mac_events();
    }
	process_all_mac_events();
	zassert_true(run_simulation_until(2000000, are_all_pts_associated), "Not all PTs became associated");

    printk("\n\n[TEST] 4. Final assertions and Association Report\n");
    for (int i=0; i<NUM_PTS; i++) {
	    zassert_true(g_mac_ctx_pt[i].role_ctx.pt.associated_ft.is_valid, "PT[%d] associated_ft is not valid", i);
        printk("  - PT[%d] (ShortID: 0x%04X) is associated with FT ShortID: 0x%04X (RSSI: %d)\n",
               i,
               g_mac_ctx_pt[i].own_short_rd_id,
               g_mac_ctx_pt[i].role_ctx.pt.associated_ft.short_rd_id,
               g_mac_ctx_pt[i].role_ctx.pt.associated_ft.rssi_2);
    }
    
    printk("\n  FT connection perspective:\n");
    for (int i=0; i<NUM_FTS; i++) {
        int pt_count = 0;
        printk("  - FT[%d] (ShortID: 0x%04X) Connected PTs:\n", i, g_mac_ctx_ft[i].own_short_rd_id);
        for (int p=0; p<MAX_PEERS_PER_FT; p++) {
            if (g_mac_ctx_ft[i].role_ctx.ft.connected_pts[p].is_valid) {
                printk("      -> Slot %d: PT ShortID: 0x%04X\n",
                       p, g_mac_ctx_ft[i].role_ctx.ft.connected_pts[p].short_rd_id);
                pt_count++;
            }
        }
        if (pt_count == 0) {
            printk("      -> (none)\n");
        }
    }
}

ZTEST_SUITE(dect_mac_assoc, 
           NULL,                    /* No suite setup */
           dect_mac_assoc_setup,   /* Suite setup (once) */
           dect_mac_assoc_before,   /* Before each test */
           dect_mac_assoc_after,    /* After each test */
           NULL);                   /* No suite cleanup */
```
