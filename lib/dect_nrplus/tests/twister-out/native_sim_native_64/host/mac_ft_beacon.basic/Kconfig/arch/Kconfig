## lib/dect_nrplus/tests/twister-out/native_sim_native_64/host/mac_ft_beacon.basic/Kconfig/soc/Kconfig.sysbuild
```kconfig
# Load Sysbuild SoC Kconfig descriptions.
osource "/home/bob/ncs/v3-zlink-U/zephyr/soc/xlnx/zynqmp/Kconfig.sysbuild"
osource "/home/bob/ncs/v3-zlink-U/zephyr/soc/xlnx/zynq7000/Kconfig.sysbuild"
osource "/home/bob/ncs/v3-zlink-U/zephyr/soc/xen/Kconfig.sysbuild"
osource "/home/bob/ncs/v3-zlink-U/zephyr/soc/wch/ch32v00x/Kconfig.sysbuild"
osource "/home/bob/ncs/v3-zlink-U/zephyr/soc/ti/simplelink/Kconfig.sysbuild"
osource "/home/bob/ncs/v3-zlink-U/zephyr/soc/ti/lm3s6965/Kconfig.sysbuild"
osource "/home/bob/ncs/v3-zlink-U/zephyr/soc/ti/k3/Kconfig.sysbuild"
osource "/home/bob/ncs/v3-zlink-U/zephyr/soc/telink/tlsr/Kconfig.sysbuild"
osource "/home/bob/ncs/v3-zlink-U/zephyr/soc/starfive/jh71xx/Kconfig.sysbuild"
osource "/home/bob/ncs/v3-zlink-U/zephyr/soc/st/stm32/Kconfig.sysbuild"
osource "/home/bob/ncs/v3-zlink-U/zephyr/soc/snps/qemu_arc/Kconfig.sysbuild"
osource "/home/bob/ncs/v3-zlink-U/zephyr/soc/snps/nsim/arc_v/Kconfig.sysbuild"
osource "/home/bob/ncs/v3-zlink-U/zephyr/soc/snps/nsim/arc_classic/Kconfig.sysbuild"
osource "/home/bob/ncs/v3-zlink-U/zephyr/soc/snps/hsdk4xd/Kconfig.sysbuild"
osource "/home/bob/ncs/v3-zlink-U/zephyr/soc/snps/hsdk/Kconfig.sysbuild"
osource "/home/bob/ncs/v3-zlink-U/zephyr/soc/snps/emsk/Kconfig.sysbuild"
osource "/home/bob/ncs/v3-zlink-U/zephyr/soc/snps/emsdp/Kconfig.sysbuild"
osource "/home/bob/ncs/v3-zlink-U/zephyr/soc/snps/arc_iot/Kconfig.sysbuild"
osource "/home/bob/ncs/v3-zlink-U/zephyr/soc/silabs/Kconfig.sysbuild"
osource "/home/bob/ncs/v3-zlink-U/zephyr/soc/sifive/sifive_freedom/Kconfig.sysbuild"
osource "/home/bob/ncs/v3-zlink-U/zephyr/soc/sensry/Kconfig.sysbuild"
osource "/home/bob/ncs/v3-zlink-U/zephyr/soc/rockchip/Kconfig.sysbuild"
osource "/home/bob/ncs/v3-zlink-U/zephyr/soc/renode/riscv_virtual/Kconfig.sysbuild"
osource "/home/bob/ncs/v3-zlink-U/zephyr/soc/renode/cortex_r8_virtual/Kconfig.sysbuild"
osource "/home/bob/ncs/v3-zlink-U/zephyr/soc/renesas/smartbond/Kconfig.sysbuild"
osource "/home/bob/ncs/v3-zlink-U/zephyr/soc/renesas/rzt2m/Kconfig.sysbuild"
osource "/home/bob/ncs/v3-zlink-U/zephyr/soc/renesas/rz/Kconfig.sysbuild"
osource "/home/bob/ncs/v3-zlink-U/zephyr/soc/renesas/rcar/Kconfig.sysbuild"
osource "/home/bob/ncs/v3-zlink-U/zephyr/soc/renesas/ra/Kconfig.sysbuild"
osource "/home/bob/ncs/v3-zlink-U/zephyr/soc/realtek/ec/Kconfig.sysbuild"
osource "/home/bob/ncs/v3-zlink-U/zephyr/soc/raspberrypi/rpi_pico/Kconfig.sysbuild"
osource "/home/bob/ncs/v3-zlink-U/zephyr/soc/quicklogic/eos_s3/Kconfig.sysbuild"
osource "/home/bob/ncs/v3-zlink-U/zephyr/soc/qemu/virt_riscv/Kconfig.sysbuild"
osource "/home/bob/ncs/v3-zlink-U/zephyr/soc/qemu/malta/Kconfig.sysbuild"
osource "/home/bob/ncs/v3-zlink-U/zephyr/soc/openisa/rv32m1/Kconfig.sysbuild"
osource "/home/bob/ncs/v3-zlink-U/zephyr/soc/nxp/s32/Kconfig.sysbuild"
osource "/home/bob/ncs/v3-zlink-U/zephyr/soc/nxp/rw/Kconfig.sysbuild"
osource "/home/bob/ncs/v3-zlink-U/zephyr/soc/nxp/mcx/Kconfig.sysbuild"
osource "/home/bob/ncs/v3-zlink-U/zephyr/soc/nxp/lpc/Kconfig.sysbuild"
osource "/home/bob/ncs/v3-zlink-U/zephyr/soc/nxp/layerscape/Kconfig.sysbuild"
osource "/home/bob/ncs/v3-zlink-U/zephyr/soc/nxp/kinetis/Kconfig.sysbuild"
osource "/home/bob/ncs/v3-zlink-U/zephyr/soc/nxp/imxrt/Kconfig.sysbuild"
osource "/home/bob/ncs/v3-zlink-U/zephyr/soc/nxp/imx/Kconfig.sysbuild"
osource "/home/bob/ncs/v3-zlink-U/zephyr/soc/nuvoton/numicro/Kconfig.sysbuild"
osource "/home/bob/ncs/v3-zlink-U/zephyr/soc/nuvoton/numaker/Kconfig.sysbuild"
osource "/home/bob/ncs/v3-zlink-U/zephyr/soc/nuvoton/npcx/Kconfig.sysbuild"
osource "/home/bob/ncs/v3-zlink-U/zephyr/soc/nuvoton/npcm/Kconfig.sysbuild"
osource "/home/bob/ncs/v3-zlink-U/zephyr/soc/nordic/Kconfig.sysbuild"
osource "/home/bob/ncs/v3-zlink-U/zephyr/soc/neorv32/Kconfig.sysbuild"
osource "/home/bob/ncs/v3-zlink-U/zephyr/soc/native/inf_clock/Kconfig.sysbuild"
osource "/home/bob/ncs/v3-zlink-U/zephyr/soc/microchip/miv/Kconfig.sysbuild"
osource "/home/bob/ncs/v3-zlink-U/zephyr/soc/microchip/mec/Kconfig.sysbuild"
osource "/home/bob/ncs/v3-zlink-U/zephyr/soc/mediatek/mt8xxx/Kconfig.sysbuild"
osource "/home/bob/ncs/v3-zlink-U/zephyr/soc/lowrisc/opentitan/Kconfig.sysbuild"
osource "/home/bob/ncs/v3-zlink-U/zephyr/soc/litex/litex_vexriscv/Kconfig.sysbuild"
osource "/home/bob/ncs/v3-zlink-U/zephyr/soc/ite/ec/Kconfig.sysbuild"
osource "/home/bob/ncs/v3-zlink-U/zephyr/soc/intel/raptor_lake/Kconfig.sysbuild"
osource "/home/bob/ncs/v3-zlink-U/zephyr/soc/intel/lakemont/Kconfig.sysbuild"
osource "/home/bob/ncs/v3-zlink-U/zephyr/soc/intel/intel_socfpga_std/Kconfig.sysbuild"
osource "/home/bob/ncs/v3-zlink-U/zephyr/soc/intel/intel_socfpga/Kconfig.sysbuild"
osource "/home/bob/ncs/v3-zlink-U/zephyr/soc/intel/intel_niosv/Kconfig.sysbuild"
osource "/home/bob/ncs/v3-zlink-U/zephyr/soc/intel/intel_ish/Kconfig.sysbuild"
osource "/home/bob/ncs/v3-zlink-U/zephyr/soc/intel/intel_adsp/Kconfig.sysbuild"
osource "/home/bob/ncs/v3-zlink-U/zephyr/soc/intel/elkhart_lake/Kconfig.sysbuild"
osource "/home/bob/ncs/v3-zlink-U/zephyr/soc/intel/atom/Kconfig.sysbuild"
osource "/home/bob/ncs/v3-zlink-U/zephyr/soc/intel/apollo_lake/Kconfig.sysbuild"
osource "/home/bob/ncs/v3-zlink-U/zephyr/soc/intel/alder_lake/Kconfig.sysbuild"
osource "/home/bob/ncs/v3-zlink-U/zephyr/soc/infineon/cat3/Kconfig.sysbuild"
osource "/home/bob/ncs/v3-zlink-U/zephyr/soc/infineon/cat1b/Kconfig.sysbuild"
osource "/home/bob/ncs/v3-zlink-U/zephyr/soc/infineon/cat1a/Kconfig.sysbuild"
osource "/home/bob/ncs/v3-zlink-U/zephyr/soc/gd/gd32/Kconfig.sysbuild"
osource "/home/bob/ncs/v3-zlink-U/zephyr/soc/gaisler/leon3/Kconfig.sysbuild"
osource "/home/bob/ncs/v3-zlink-U/zephyr/soc/gaisler/gr716a/Kconfig.sysbuild"
osource "/home/bob/ncs/v3-zlink-U/zephyr/soc/espressif/Kconfig.sysbuild"
osource "/home/bob/ncs/v3-zlink-U/zephyr/soc/ene/kb1200/Kconfig.sysbuild"
osource "/home/bob/ncs/v3-zlink-U/zephyr/soc/efinix/sapphire/Kconfig.sysbuild"
osource "/home/bob/ncs/v3-zlink-U/zephyr/soc/cdns/xtensa_sample_controller/Kconfig.sysbuild"
osource "/home/bob/ncs/v3-zlink-U/zephyr/soc/cdns/sample_controller32/Kconfig.sysbuild"
osource "/home/bob/ncs/v3-zlink-U/zephyr/soc/cdns/dc233c/Kconfig.sysbuild"
osource "/home/bob/ncs/v3-zlink-U/zephyr/soc/brcm/bcmvk/Kconfig.sysbuild"
osource "/home/bob/ncs/v3-zlink-U/zephyr/soc/brcm/bcm2712/Kconfig.sysbuild"
osource "/home/bob/ncs/v3-zlink-U/zephyr/soc/brcm/bcm2711/Kconfig.sysbuild"
osource "/home/bob/ncs/v3-zlink-U/zephyr/soc/atmel/sam0/Kconfig.sysbuild"
osource "/home/bob/ncs/v3-zlink-U/zephyr/soc/atmel/sam/Kconfig.sysbuild"
osource "/home/bob/ncs/v3-zlink-U/zephyr/soc/aspeed/Kconfig.sysbuild"
osource "/home/bob/ncs/v3-zlink-U/zephyr/soc/arm/Kconfig.sysbuild"
osource "/home/bob/ncs/v3-zlink-U/zephyr/soc/arm/beetle/Kconfig.sysbuild"
osource "/home/bob/ncs/v3-zlink-U/zephyr/soc/andestech/Kconfig.sysbuild"
osource "/home/bob/ncs/v3-zlink-U/zephyr/soc/amd/acp_6_0/Kconfig.sysbuild"
osource "/home/bob/ncs/v3-zlink-U/zephyr/soc/ambiq/Kconfig.sysbuild"
osource "/home/bob/ncs/v3-zlink-U/zephyr/soc/altr/zephyr_nios2f/Kconfig.sysbuild"
osource "/home/bob/ncs/v3-zlink-U/zephyr/soc/altr/qemu_nios2/Kconfig.sysbuild"
osource "/home/bob/ncs/v3-zlink-U/zephyr/soc/adi/max32/Kconfig.sysbuild"
osource "/home/bob/ncs/v3-zlink-U/nrf/soc/nordic/Kconfig.sysbuild"
```
