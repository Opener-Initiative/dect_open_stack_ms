## lib/dect_nrplus/tests/twister-out/native_sim_native_64/host/mac_ft_beacon.basic/Kconfig/arch/Kconfig
```kconfig
# Load Zephyr Arch Kconfig descriptions.
osource "/home/bob/ncs/v3-zlink-U/zephyr/arch/x86/Kconfig"
osource "/home/bob/ncs/v3-zlink-U/zephyr/arch/xtensa/Kconfig"
osource "/home/bob/ncs/v3-zlink-U/zephyr/arch/sparc/Kconfig"
osource "/home/bob/ncs/v3-zlink-U/zephyr/arch/riscv/Kconfig"
osource "/home/bob/ncs/v3-zlink-U/zephyr/arch/posix/Kconfig"
osource "/home/bob/ncs/v3-zlink-U/zephyr/arch/nios2/Kconfig"
osource "/home/bob/ncs/v3-zlink-U/zephyr/arch/mips/Kconfig"
osource "/home/bob/ncs/v3-zlink-U/zephyr/arch/arm64/Kconfig"
osource "/home/bob/ncs/v3-zlink-U/zephyr/arch/arm/Kconfig"
osource "/home/bob/ncs/v3-zlink-U/zephyr/arch/arc/Kconfig"
```

## lib/dect_nrplus/tests/twister-out/native_sim_native_64/host/mac_ft_beacon.basic/Kconfig/boards/Kconfig.defconfig
```kconfig
# Load Zephyr board defconfig descriptions.
osource "/home/bob/ncs/v3-zlink-U/zephyr/boards/native/native_sim/Kconfig.defconfig"
```

## lib/dect_nrplus/tests/twister-out/native_sim_native_64/host/mac_ft_beacon.basic/Kconfig/boards/Kconfig.sysbuild
```kconfig
# Load Sysbuild board Kconfig descriptions.
osource "/home/bob/ncs/v3-zlink-U/zephyr/boards/native/native_sim/Kconfig.sysbuild"
```

## lib/dect_nrplus/tests/twister-out/native_sim_native_64/host/mac_ft_beacon.basic/Kconfig/soc/Kconfig
```kconfig
# Load Zephyr SoC Kconfig descriptions.
osource "/home/bob/ncs/v3-zlink-U/zephyr/soc/xlnx/zynqmp/Kconfig"
osource "/home/bob/ncs/v3-zlink-U/zephyr/soc/xlnx/zynq7000/Kconfig"
osource "/home/bob/ncs/v3-zlink-U/zephyr/soc/xen/Kconfig"
osource "/home/bob/ncs/v3-zlink-U/zephyr/soc/wch/ch32v00x/Kconfig"
osource "/home/bob/ncs/v3-zlink-U/zephyr/soc/ti/simplelink/Kconfig"
osource "/home/bob/ncs/v3-zlink-U/zephyr/soc/ti/lm3s6965/Kconfig"
osource "/home/bob/ncs/v3-zlink-U/zephyr/soc/ti/k3/Kconfig"
osource "/home/bob/ncs/v3-zlink-U/zephyr/soc/telink/tlsr/Kconfig"
osource "/home/bob/ncs/v3-zlink-U/zephyr/soc/starfive/jh71xx/Kconfig"
osource "/home/bob/ncs/v3-zlink-U/zephyr/soc/st/stm32/Kconfig"
osource "/home/bob/ncs/v3-zlink-U/zephyr/soc/snps/qemu_arc/Kconfig"
osource "/home/bob/ncs/v3-zlink-U/zephyr/soc/snps/nsim/arc_v/Kconfig"
osource "/home/bob/ncs/v3-zlink-U/zephyr/soc/snps/nsim/arc_classic/Kconfig"
osource "/home/bob/ncs/v3-zlink-U/zephyr/soc/snps/hsdk4xd/Kconfig"
osource "/home/bob/ncs/v3-zlink-U/zephyr/soc/snps/hsdk/Kconfig"
osource "/home/bob/ncs/v3-zlink-U/zephyr/soc/snps/emsk/Kconfig"
osource "/home/bob/ncs/v3-zlink-U/zephyr/soc/snps/emsdp/Kconfig"
osource "/home/bob/ncs/v3-zlink-U/zephyr/soc/snps/arc_iot/Kconfig"
osource "/home/bob/ncs/v3-zlink-U/zephyr/soc/silabs/Kconfig"
osource "/home/bob/ncs/v3-zlink-U/zephyr/soc/sifive/sifive_freedom/Kconfig"
osource "/home/bob/ncs/v3-zlink-U/zephyr/soc/sensry/Kconfig"
osource "/home/bob/ncs/v3-zlink-U/zephyr/soc/rockchip/Kconfig"
osource "/home/bob/ncs/v3-zlink-U/zephyr/soc/renode/riscv_virtual/Kconfig"
osource "/home/bob/ncs/v3-zlink-U/zephyr/soc/renode/cortex_r8_virtual/Kconfig"
osource "/home/bob/ncs/v3-zlink-U/zephyr/soc/renesas/smartbond/Kconfig"
osource "/home/bob/ncs/v3-zlink-U/zephyr/soc/renesas/rzt2m/Kconfig"
osource "/home/bob/ncs/v3-zlink-U/zephyr/soc/renesas/rz/Kconfig"
osource "/home/bob/ncs/v3-zlink-U/zephyr/soc/renesas/rcar/Kconfig"
osource "/home/bob/ncs/v3-zlink-U/zephyr/soc/renesas/ra/Kconfig"
osource "/home/bob/ncs/v3-zlink-U/zephyr/soc/realtek/ec/Kconfig"
osource "/home/bob/ncs/v3-zlink-U/zephyr/soc/raspberrypi/rpi_pico/Kconfig"
osource "/home/bob/ncs/v3-zlink-U/zephyr/soc/quicklogic/eos_s3/Kconfig"
osource "/home/bob/ncs/v3-zlink-U/zephyr/soc/qemu/virt_riscv/Kconfig"
osource "/home/bob/ncs/v3-zlink-U/zephyr/soc/qemu/malta/Kconfig"
osource "/home/bob/ncs/v3-zlink-U/zephyr/soc/openisa/rv32m1/Kconfig"
osource "/home/bob/ncs/v3-zlink-U/zephyr/soc/nxp/s32/Kconfig"
osource "/home/bob/ncs/v3-zlink-U/zephyr/soc/nxp/rw/Kconfig"
osource "/home/bob/ncs/v3-zlink-U/zephyr/soc/nxp/mcx/Kconfig"
osource "/home/bob/ncs/v3-zlink-U/zephyr/soc/nxp/lpc/Kconfig"
osource "/home/bob/ncs/v3-zlink-U/zephyr/soc/nxp/layerscape/Kconfig"
osource "/home/bob/ncs/v3-zlink-U/zephyr/soc/nxp/kinetis/Kconfig"
osource "/home/bob/ncs/v3-zlink-U/zephyr/soc/nxp/imxrt/Kconfig"
osource "/home/bob/ncs/v3-zlink-U/zephyr/soc/nxp/imx/Kconfig"
osource "/home/bob/ncs/v3-zlink-U/zephyr/soc/nuvoton/numicro/Kconfig"
osource "/home/bob/ncs/v3-zlink-U/zephyr/soc/nuvoton/numaker/Kconfig"
osource "/home/bob/ncs/v3-zlink-U/zephyr/soc/nuvoton/npcx/Kconfig"
osource "/home/bob/ncs/v3-zlink-U/zephyr/soc/nuvoton/npcm/Kconfig"
osource "/home/bob/ncs/v3-zlink-U/zephyr/soc/nordic/Kconfig"
osource "/home/bob/ncs/v3-zlink-U/zephyr/soc/neorv32/Kconfig"
osource "/home/bob/ncs/v3-zlink-U/zephyr/soc/native/inf_clock/Kconfig"
osource "/home/bob/ncs/v3-zlink-U/zephyr/soc/microchip/miv/Kconfig"
osource "/home/bob/ncs/v3-zlink-U/zephyr/soc/microchip/mec/Kconfig"
osource "/home/bob/ncs/v3-zlink-U/zephyr/soc/mediatek/mt8xxx/Kconfig"
osource "/home/bob/ncs/v3-zlink-U/zephyr/soc/lowrisc/opentitan/Kconfig"
osource "/home/bob/ncs/v3-zlink-U/zephyr/soc/litex/litex_vexriscv/Kconfig"
osource "/home/bob/ncs/v3-zlink-U/zephyr/soc/ite/ec/Kconfig"
osource "/home/bob/ncs/v3-zlink-U/zephyr/soc/intel/raptor_lake/Kconfig"
osource "/home/bob/ncs/v3-zlink-U/zephyr/soc/intel/lakemont/Kconfig"
osource "/home/bob/ncs/v3-zlink-U/zephyr/soc/intel/intel_socfpga_std/Kconfig"
osource "/home/bob/ncs/v3-zlink-U/zephyr/soc/intel/intel_socfpga/Kconfig"
osource "/home/bob/ncs/v3-zlink-U/zephyr/soc/intel/intel_niosv/Kconfig"
osource "/home/bob/ncs/v3-zlink-U/zephyr/soc/intel/intel_ish/Kconfig"
osource "/home/bob/ncs/v3-zlink-U/zephyr/soc/intel/intel_adsp/Kconfig"
osource "/home/bob/ncs/v3-zlink-U/zephyr/soc/intel/elkhart_lake/Kconfig"
osource "/home/bob/ncs/v3-zlink-U/zephyr/soc/intel/atom/Kconfig"
osource "/home/bob/ncs/v3-zlink-U/zephyr/soc/intel/apollo_lake/Kconfig"
osource "/home/bob/ncs/v3-zlink-U/zephyr/soc/intel/alder_lake/Kconfig"
osource "/home/bob/ncs/v3-zlink-U/zephyr/soc/infineon/cat3/Kconfig"
osource "/home/bob/ncs/v3-zlink-U/zephyr/soc/infineon/cat1b/Kconfig"
osource "/home/bob/ncs/v3-zlink-U/zephyr/soc/infineon/cat1a/Kconfig"
osource "/home/bob/ncs/v3-zlink-U/zephyr/soc/gd/gd32/Kconfig"
osource "/home/bob/ncs/v3-zlink-U/zephyr/soc/gaisler/leon3/Kconfig"
osource "/home/bob/ncs/v3-zlink-U/zephyr/soc/gaisler/gr716a/Kconfig"
osource "/home/bob/ncs/v3-zlink-U/zephyr/soc/espressif/Kconfig"
osource "/home/bob/ncs/v3-zlink-U/zephyr/soc/ene/kb1200/Kconfig"
osource "/home/bob/ncs/v3-zlink-U/zephyr/soc/efinix/sapphire/Kconfig"
osource "/home/bob/ncs/v3-zlink-U/zephyr/soc/cdns/xtensa_sample_controller/Kconfig"
osource "/home/bob/ncs/v3-zlink-U/zephyr/soc/cdns/sample_controller32/Kconfig"
osource "/home/bob/ncs/v3-zlink-U/zephyr/soc/cdns/dc233c/Kconfig"
osource "/home/bob/ncs/v3-zlink-U/zephyr/soc/brcm/bcmvk/Kconfig"
osource "/home/bob/ncs/v3-zlink-U/zephyr/soc/brcm/bcm2712/Kconfig"
osource "/home/bob/ncs/v3-zlink-U/zephyr/soc/brcm/bcm2711/Kconfig"
osource "/home/bob/ncs/v3-zlink-U/zephyr/soc/atmel/sam0/Kconfig"
osource "/home/bob/ncs/v3-zlink-U/zephyr/soc/atmel/sam/Kconfig"
osource "/home/bob/ncs/v3-zlink-U/zephyr/soc/aspeed/Kconfig"
osource "/home/bob/ncs/v3-zlink-U/zephyr/soc/arm/Kconfig"
osource "/home/bob/ncs/v3-zlink-U/zephyr/soc/arm/beetle/Kconfig"
osource "/home/bob/ncs/v3-zlink-U/zephyr/soc/andestech/Kconfig"
osource "/home/bob/ncs/v3-zlink-U/zephyr/soc/amd/acp_6_0/Kconfig"
osource "/home/bob/ncs/v3-zlink-U/zephyr/soc/ambiq/Kconfig"
osource "/home/bob/ncs/v3-zlink-U/zephyr/soc/altr/zephyr_nios2f/Kconfig"
osource "/home/bob/ncs/v3-zlink-U/zephyr/soc/altr/qemu_nios2/Kconfig"
osource "/home/bob/ncs/v3-zlink-U/zephyr/soc/adi/max32/Kconfig"
osource "/home/bob/ncs/v3-zlink-U/nrf/soc/nordic/Kconfig"
```

## lib/dect_nrplus/tests/twister-out/native_sim_native_64/host/mac_ft_beacon.basic/Kconfig/soc/Kconfig.defconfig
```kconfig
# Load Zephyr SoC defconfig descriptions.
osource "/home/bob/ncs/v3-zlink-U/zephyr/soc/xlnx/zynqmp/Kconfig.defconfig"
osource "/home/bob/ncs/v3-zlink-U/zephyr/soc/xlnx/zynq7000/Kconfig.defconfig"
osource "/home/bob/ncs/v3-zlink-U/zephyr/soc/xen/Kconfig.defconfig"
osource "/home/bob/ncs/v3-zlink-U/zephyr/soc/wch/ch32v00x/Kconfig.defconfig"
osource "/home/bob/ncs/v3-zlink-U/zephyr/soc/ti/simplelink/Kconfig.defconfig"
osource "/home/bob/ncs/v3-zlink-U/zephyr/soc/ti/lm3s6965/Kconfig.defconfig"
osource "/home/bob/ncs/v3-zlink-U/zephyr/soc/ti/k3/Kconfig.defconfig"
osource "/home/bob/ncs/v3-zlink-U/zephyr/soc/telink/tlsr/Kconfig.defconfig"
osource "/home/bob/ncs/v3-zlink-U/zephyr/soc/starfive/jh71xx/Kconfig.defconfig"
osource "/home/bob/ncs/v3-zlink-U/zephyr/soc/st/stm32/Kconfig.defconfig"
osource "/home/bob/ncs/v3-zlink-U/zephyr/soc/snps/qemu_arc/Kconfig.defconfig"
osource "/home/bob/ncs/v3-zlink-U/zephyr/soc/snps/nsim/arc_v/Kconfig.defconfig"
osource "/home/bob/ncs/v3-zlink-U/zephyr/soc/snps/nsim/arc_classic/Kconfig.defconfig"
osource "/home/bob/ncs/v3-zlink-U/zephyr/soc/snps/hsdk4xd/Kconfig.defconfig"
osource "/home/bob/ncs/v3-zlink-U/zephyr/soc/snps/hsdk/Kconfig.defconfig"
osource "/home/bob/ncs/v3-zlink-U/zephyr/soc/snps/emsk/Kconfig.defconfig"
osource "/home/bob/ncs/v3-zlink-U/zephyr/soc/snps/emsdp/Kconfig.defconfig"
osource "/home/bob/ncs/v3-zlink-U/zephyr/soc/snps/arc_iot/Kconfig.defconfig"
osource "/home/bob/ncs/v3-zlink-U/zephyr/soc/silabs/Kconfig.defconfig"
osource "/home/bob/ncs/v3-zlink-U/zephyr/soc/sifive/sifive_freedom/Kconfig.defconfig"
osource "/home/bob/ncs/v3-zlink-U/zephyr/soc/sensry/Kconfig.defconfig"
osource "/home/bob/ncs/v3-zlink-U/zephyr/soc/rockchip/Kconfig.defconfig"
osource "/home/bob/ncs/v3-zlink-U/zephyr/soc/renode/riscv_virtual/Kconfig.defconfig"
osource "/home/bob/ncs/v3-zlink-U/zephyr/soc/renode/cortex_r8_virtual/Kconfig.defconfig"
osource "/home/bob/ncs/v3-zlink-U/zephyr/soc/renesas/smartbond/Kconfig.defconfig"
osource "/home/bob/ncs/v3-zlink-U/zephyr/soc/renesas/rzt2m/Kconfig.defconfig"
osource "/home/bob/ncs/v3-zlink-U/zephyr/soc/renesas/rz/Kconfig.defconfig"
osource "/home/bob/ncs/v3-zlink-U/zephyr/soc/renesas/rcar/Kconfig.defconfig"
osource "/home/bob/ncs/v3-zlink-U/zephyr/soc/renesas/ra/Kconfig.defconfig"
osource "/home/bob/ncs/v3-zlink-U/zephyr/soc/realtek/ec/Kconfig.defconfig"
osource "/home/bob/ncs/v3-zlink-U/zephyr/soc/raspberrypi/rpi_pico/Kconfig.defconfig"
osource "/home/bob/ncs/v3-zlink-U/zephyr/soc/quicklogic/eos_s3/Kconfig.defconfig"
osource "/home/bob/ncs/v3-zlink-U/zephyr/soc/qemu/virt_riscv/Kconfig.defconfig"
osource "/home/bob/ncs/v3-zlink-U/zephyr/soc/qemu/malta/Kconfig.defconfig"
osource "/home/bob/ncs/v3-zlink-U/zephyr/soc/openisa/rv32m1/Kconfig.defconfig"
osource "/home/bob/ncs/v3-zlink-U/zephyr/soc/nxp/s32/Kconfig.defconfig"
osource "/home/bob/ncs/v3-zlink-U/zephyr/soc/nxp/rw/Kconfig.defconfig"
osource "/home/bob/ncs/v3-zlink-U/zephyr/soc/nxp/mcx/Kconfig.defconfig"
osource "/home/bob/ncs/v3-zlink-U/zephyr/soc/nxp/lpc/Kconfig.defconfig"
osource "/home/bob/ncs/v3-zlink-U/zephyr/soc/nxp/layerscape/Kconfig.defconfig"
osource "/home/bob/ncs/v3-zlink-U/zephyr/soc/nxp/kinetis/Kconfig.defconfig"
osource "/home/bob/ncs/v3-zlink-U/zephyr/soc/nxp/imxrt/Kconfig.defconfig"
osource "/home/bob/ncs/v3-zlink-U/zephyr/soc/nxp/imx/Kconfig.defconfig"
osource "/home/bob/ncs/v3-zlink-U/zephyr/soc/nuvoton/numicro/Kconfig.defconfig"
osource "/home/bob/ncs/v3-zlink-U/zephyr/soc/nuvoton/numaker/Kconfig.defconfig"
osource "/home/bob/ncs/v3-zlink-U/zephyr/soc/nuvoton/npcx/Kconfig.defconfig"
osource "/home/bob/ncs/v3-zlink-U/zephyr/soc/nuvoton/npcm/Kconfig.defconfig"
osource "/home/bob/ncs/v3-zlink-U/zephyr/soc/nordic/Kconfig.defconfig"
osource "/home/bob/ncs/v3-zlink-U/zephyr/soc/neorv32/Kconfig.defconfig"
osource "/home/bob/ncs/v3-zlink-U/zephyr/soc/native/inf_clock/Kconfig.defconfig"
osource "/home/bob/ncs/v3-zlink-U/zephyr/soc/microchip/miv/Kconfig.defconfig"
osource "/home/bob/ncs/v3-zlink-U/zephyr/soc/microchip/mec/Kconfig.defconfig"
osource "/home/bob/ncs/v3-zlink-U/zephyr/soc/mediatek/mt8xxx/Kconfig.defconfig"
osource "/home/bob/ncs/v3-zlink-U/zephyr/soc/lowrisc/opentitan/Kconfig.defconfig"
osource "/home/bob/ncs/v3-zlink-U/zephyr/soc/litex/litex_vexriscv/Kconfig.defconfig"
osource "/home/bob/ncs/v3-zlink-U/zephyr/soc/ite/ec/Kconfig.defconfig"
osource "/home/bob/ncs/v3-zlink-U/zephyr/soc/intel/raptor_lake/Kconfig.defconfig"
osource "/home/bob/ncs/v3-zlink-U/zephyr/soc/intel/lakemont/Kconfig.defconfig"
osource "/home/bob/ncs/v3-zlink-U/zephyr/soc/intel/intel_socfpga_std/Kconfig.defconfig"
osource "/home/bob/ncs/v3-zlink-U/zephyr/soc/intel/intel_socfpga/Kconfig.defconfig"
osource "/home/bob/ncs/v3-zlink-U/zephyr/soc/intel/intel_niosv/Kconfig.defconfig"
osource "/home/bob/ncs/v3-zlink-U/zephyr/soc/intel/intel_ish/Kconfig.defconfig"
osource "/home/bob/ncs/v3-zlink-U/zephyr/soc/intel/intel_adsp/Kconfig.defconfig"
osource "/home/bob/ncs/v3-zlink-U/zephyr/soc/intel/elkhart_lake/Kconfig.defconfig"
osource "/home/bob/ncs/v3-zlink-U/zephyr/soc/intel/atom/Kconfig.defconfig"
osource "/home/bob/ncs/v3-zlink-U/zephyr/soc/intel/apollo_lake/Kconfig.defconfig"
osource "/home/bob/ncs/v3-zlink-U/zephyr/soc/intel/alder_lake/Kconfig.defconfig"
osource "/home/bob/ncs/v3-zlink-U/zephyr/soc/infineon/cat3/Kconfig.defconfig"
osource "/home/bob/ncs/v3-zlink-U/zephyr/soc/infineon/cat1b/Kconfig.defconfig"
osource "/home/bob/ncs/v3-zlink-U/zephyr/soc/infineon/cat1a/Kconfig.defconfig"
osource "/home/bob/ncs/v3-zlink-U/zephyr/soc/gd/gd32/Kconfig.defconfig"
osource "/home/bob/ncs/v3-zlink-U/zephyr/soc/gaisler/leon3/Kconfig.defconfig"
osource "/home/bob/ncs/v3-zlink-U/zephyr/soc/gaisler/gr716a/Kconfig.defconfig"
osource "/home/bob/ncs/v3-zlink-U/zephyr/soc/espressif/Kconfig.defconfig"
osource "/home/bob/ncs/v3-zlink-U/zephyr/soc/ene/kb1200/Kconfig.defconfig"
osource "/home/bob/ncs/v3-zlink-U/zephyr/soc/efinix/sapphire/Kconfig.defconfig"
osource "/home/bob/ncs/v3-zlink-U/zephyr/soc/cdns/xtensa_sample_controller/Kconfig.defconfig"
osource "/home/bob/ncs/v3-zlink-U/zephyr/soc/cdns/sample_controller32/Kconfig.defconfig"
osource "/home/bob/ncs/v3-zlink-U/zephyr/soc/cdns/dc233c/Kconfig.defconfig"
osource "/home/bob/ncs/v3-zlink-U/zephyr/soc/brcm/bcmvk/Kconfig.defconfig"
osource "/home/bob/ncs/v3-zlink-U/zephyr/soc/brcm/bcm2712/Kconfig.defconfig"
osource "/home/bob/ncs/v3-zlink-U/zephyr/soc/brcm/bcm2711/Kconfig.defconfig"
osource "/home/bob/ncs/v3-zlink-U/zephyr/soc/atmel/sam0/Kconfig.defconfig"
osource "/home/bob/ncs/v3-zlink-U/zephyr/soc/atmel/sam/Kconfig.defconfig"
osource "/home/bob/ncs/v3-zlink-U/zephyr/soc/aspeed/Kconfig.defconfig"
osource "/home/bob/ncs/v3-zlink-U/zephyr/soc/arm/Kconfig.defconfig"
osource "/home/bob/ncs/v3-zlink-U/zephyr/soc/arm/beetle/Kconfig.defconfig"
osource "/home/bob/ncs/v3-zlink-U/zephyr/soc/andestech/Kconfig.defconfig"
osource "/home/bob/ncs/v3-zlink-U/zephyr/soc/amd/acp_6_0/Kconfig.defconfig"
osource "/home/bob/ncs/v3-zlink-U/zephyr/soc/ambiq/Kconfig.defconfig"
osource "/home/bob/ncs/v3-zlink-U/zephyr/soc/altr/zephyr_nios2f/Kconfig.defconfig"
osource "/home/bob/ncs/v3-zlink-U/zephyr/soc/altr/qemu_nios2/Kconfig.defconfig"
osource "/home/bob/ncs/v3-zlink-U/zephyr/soc/adi/max32/Kconfig.defconfig"
osource "/home/bob/ncs/v3-zlink-U/nrf/soc/nordic/Kconfig.defconfig"
```
