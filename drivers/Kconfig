## lib/dect_nrplus/Kconfig.dect_module
```kconfig
# /* lib/dect_nrplus/Kconfig.dect_module */
# // Overview: Restructures the entire file to source layer Kconfigs first, resolving dependency order issues. It also moves the logging menu outside the main if-block to make it available for test builds.
#
# Copyright (c) 2023 Nordic Semiconductor ASA
#
# SPDX-License-Identifier: LicenseRef-Nordic-5-Clause
#

menuconfig DECT_NRPLUS_STACK
	bool "DECT NR+ Protocol Stack Library"
	select PM_DEVICE
	select PRINTK
	select POLL
	select CBPRINTF_FP_SUPPORT
	help
	  Enable the full DECT NR+ protocol stack, including the MAC, DLC,
	  and CVG layers. This is typically selected automatically by a
	  higher-level component, such as the DECT NR+ radio driver.

if DECT_NRPLUS_STACK

config DECT_APP_MAIN_LOG_LEVEL
	int "Log level for the main application"
	default 3
	range 0 4
	depends on LOG
	help
	  Log level for the main application logic contained in
	  dect_mac_main.c. This is separate from the log levels of the
	  individual stack modules.
	  0=off, 1=error, 2=warning, 3=info, 4=debug.

config DECT_APP_TX_INTERVAL_S
	int "Application test TX interval (seconds)"
	default 10
	help
	  The interval, in seconds, at which the example application logic
	  in dect_mac_main.c will attempt to send a burst of test packets.

endif # DECT_NRPLUS_STACK

# This menu is defined outside the main if-block so that test configurations
# (where DECT_NRPLUS_STACK=n) can still see and set these log levels.
menu "DECT NR+ Stack Logging Levels"
	depends on LOG && (DECT_NRPLUS_STACK || ZTEST)

	# --- L2 Driver Log Level ---
	config DECT_NRPLUS_LOG_LEVEL
		int "L2 Driver Log Level"
		default 3
		range 0 4
		help
		  Log level for the DECT NR+ L2 network driver.
		  0=off, 1=error, 2=warning, 3=info, 4=debug.

	# --- Convergence (CVG) Layer Log Level ---
	config DECT_CVG_LOG_LEVEL
		int "CVG Layer Log Level"
		default 3
		range 0 4
		help
		  Log level for the DECT NR+ Convergence (CVG) layer.

	# --- Data Link Control (DLC) Layer Log Level ---
	config DECT_DLC_LOG_LEVEL
		int "DLC Layer Log Level"
		default 3
		range 0 4
		help
		  Log level for the DECT NR+ Data Link Control (DLC) layer.

	# --- Configuration Data Distribution (CDD) Service Log Level ---
	config DECT_CDD_LOG_LEVEL
		int "CDD Service Log Level"
		default 3
		range 0 4
		help
		  Log level for the Configuration Data Distribution (CDD) service.

	# --- MAC Layer Submodule Log Levels ---
	menu "MAC Layer Submodule Logging"
		depends on DECT_MAC_LAYER

		config DECT_MAC_API_LOG_LEVEL
			int "Log level for MAC API"
			default 3
			range 0 4
			help
			  Log level for the DECT MAC API module.

		config DECT_MAC_CORE_LOG_LEVEL
			int "Log level for MAC Core"
			default 3
			range 0 4
			help
			  Log level for the DECT MAC Core module.

		config DECT_MAC_DATA_PATH_LOG_LEVEL
			int "Log level for MAC Data Path"
			default 3
			range 0 4
			help
			  Log level for the DECT MAC Data Path module.

		config DECT_MAC_DISPATCHER_LOG_LEVEL
			int "Log level for MAC Main Dispatcher"
			default 3
			range 0 4
			help
			  Log level for the DECT MAC Main Dispatcher module.

		config DECT_MAC_MGMT_LOG_LEVEL
			int "Log level for MAC Management Service"
			default 3
			range 0 4
			help
			  Log level for the DECT MAC Management Service module.

		config DECT_MAC_NVS_LOG_LEVEL
			int "Log level for MAC NVS"
			default 3
			range 0 4
			help
			  Log level for the DECT MAC NVS module.

		config DECT_MAC_PDU_LOG_LEVEL
			int "Log level for MAC PDU (De)serializers"
			default 3
			range 0 4
			help
			  Log level for the DECT MAC PDU module.

		config DECT_MAC_PHY_CTRL_LOG_LEVEL
			int "Log level for MAC PHY Control"
			default 3
			range 0 4
			help
			  Log level for the DECT MAC PHY Control module.

		config DECT_MAC_PHY_IF_LOG_LEVEL
			int "Log level for MAC PHY Interface"
			default 3
			range 0 4
			help
			  Log level for the DECT MAC PHY Interface module.

		config DECT_MAC_SECURITY_LOG_LEVEL
			int "Log level for MAC Security"
			default 3
			range 0 4
			help
			  Log level for the DECT MAC Security module.

		config DECT_MAC_SM_FT_LOG_LEVEL
			int "Log level for MAC FT State Machine"
			default 3
			range 0 4
			help
			  Log level for the DECT MAC FT State Machine module.

		config DECT_MAC_SM_PT_LOG_LEVEL
			int "Log level for MAC PT State Machine"
			default 3
			range 0 4
			help
			  Log level for the DECT MAC PT State Machine module.

		config DECT_MAC_SHELL_LOG_LEVEL
			int "Log level for MAC Shell"
			default 3
			range 0 4
			depends on DECT_MAC_SHELL_ENABLE
			help
			  Log level for the DECT MAC Shell module.

	endmenu # MAC Layer Submodule Logging

endmenu # DECT NR+ Stack Logging Levels


# Source the Kconfig files for each layer of the stack first.
# This ensures their main symbols (e.g., DECT_MAC_LAYER) are defined
# before being used as dependencies in menus below.

source "../nrf/lib/dect_nrplus/Kconfig.dect_mac"
source "../nrf/lib/dect_nrplus/Kconfig.dect_dlc"
source "../nrf/lib/dect_nrplus/Kconfig.dect_cvg"
source "../nrf/lib/dect_nrplus/Kconfig.dect_cdd"
source "../nrf/lib/dect_nrplus/Kconfig.dect_security"
source "../nrf/drivers/net/dect_nrplus/Kconfig.dect_nrplus"
```

## lib/dect_nrplus/Kconfig.dect_nrplus
```kconfig
# /* lib/dect_nrplus/Kconfig.dect_nrplus */
# Kconfig for DECT NR+ L2 Driver Integration

# This Kconfig fragment should be sourced by a higher-level Kconfig file,
# typically drivers/net/Kconfig
menuconfig NET_L2_DECT_NRPLUS
	bool "DECT NR+ L2 network driver"
	depends on NETWORKING && DECT_NRPLUS_STACK
	select NET_L2_6LO if NET_IPV6
	help
	  Enable the DECT NR+ L2 network driver. This driver acts as the
	  glue between the DECT NR+ protocol stack (CVG/DLC/MAC) and the
	  Zephyr IP stack, enabling IP-based communication over DECT NR+.

if NET_L2_DECT_NRPLUS

	config DECT_NRPLUS_RX_THREAD_STACK_SIZE
		int "DECT NR+ L2 driver RX thread stack size"
		default 2048
		help
		  Stack size for the DECT NR+ L2 driver's RX thread. This thread
		  receives data from the CVG layer and passes it up to the IP stack.
		  Ensure this is adequate for CVG receive calls and net_pkt handling.

	config DECT_NRPLUS_RX_THREAD_PRIORITY
		int "DECT NR+ L2 driver RX thread priority"
		default 6 # Slightly higher than default app threads, but lower than MAC thread
		help
		  Priority for the DECT NR+ L2 driver's RX thread.

	config DECT_NRPLUS_INIT_PRIORITY
		int "DECT NR+ L2 driver initialization priority"
		default 80 # Typical for network drivers
		help
		  Initialization priority of the DECT NR+ L2 network driver.

endif # NET_L2_DECT_NRPLUS
```

## lib/dect_nrplus/Kconfig.dect_security
```kconfig
# Kconfig.dect_security
# Security subsystem configuration for DECT NR+ driver

config DECT_SECURITY_ENABLE
	bool "Enable DECT NR+ Security Subsystem"
	help
	  Enable the unified security subsystem for DECT NR+ MAC and CVG layers.
	  This provides encryption and authentication services.

if DECT_SECURITY_ENABLE

choice DECT_CRYPTO_BACKEND
	prompt "Cryptographic backend"
	default DECT_CRYPTO_PSA
	help
	  Select the cryptographic backend for DECT NR+ security operations.

# config DECT_CRYPTO_PSA
# 	bool "PSA Crypto API"
# 	select MBEDTLS
# 	select MBEDTLS_PSA_CRYPTO_C
# 	select PSA_CRYPTO_INIT
# 	select PSA_WANT_ALG_CTR
# 	select PSA_WANT_ALG_CMAC
# 	select PSA_WANT_ALG_ECB_NO_PADDING
# 	select PSA_WANT_KEY_TYPE_AES
# 	select PSA_WANT_AES_KEY_SIZE_128
# 	help
# 	  Use PSA Crypto API for cryptographic operations.
# 	  This is the default and recommended backend.
config DECT_CRYPTO_PSA
	bool "PSA Crypto API"
	select MBEDTLS
	select MBEDTLS_PSA_CRYPTO_C
	
	# Fixes the 'fatal error: psa/crypto.h' on the simulator
	select PSA_CRYPTO_CLIENT if !NRF_SECURITY
	
	# Hardware-specific algorithms (only exist when NRF_SECURITY=y)
	select PSA_CRYPTO_INIT if NRF_SECURITY
	select PSA_WANT_ALG_CTR if NRF_SECURITY
	select PSA_WANT_ALG_CMAC if NRF_SECURITY
	select PSA_WANT_ALG_ECB_NO_PADDING if NRF_SECURITY
	select PSA_WANT_KEY_TYPE_AES if NRF_SECURITY
	select PSA_WANT_AES_KEY_SIZE_128 if NRF_SECURITY
	help
	  Use PSA Crypto API for cryptographic operations.
	  

config DECT_CRYPTO_TINYCRYPT
	bool "TinyCrypt"
	depends on !NRF_SECURITY
	help
	  Use TinyCrypt for cryptographic operations.
	  This is a lightweight alternative for platforms without PSA support.
	  Note: Not yet implemented.

endchoice

config DECT_SECURITY_LOG_LEVEL
	int "DECT Security log level"
	default 3
	range 0 4
	help
	  Log level for the DECT security subsystem.
	  0=off, 1=error, 2=warning, 3=info, 4=debug

endif # DECT_SECURITY_ENABLE
```

## lib/dect_nrplus/tests/advanced_mac/testcase.yaml
```yaml
tests:
  mac.advanced:
    tags: dect_nrplus mac sm advanced
    platform_allow: 
      - native_sim
      - native_sim/native
      - native_sim/native/64
      - nrf9161dk/nrf9161/ns
    integration_platforms:
      - native_sim
      - native_sim/native
      - native_sim/native/64
      - nrf9161dk/nrf9161/ns
    harness: ztest
 
```

## lib/dect_nrplus/tests/cvg_advanced/testcase.yaml
```yaml
tests:
  testing.dect_nrplus.cvg.advanced:
    tags: dect_nrplus cvg arq fc
    platform_allow: 
      - native_sim
      - native_sim/native
      - native_sim/native/64
      - nrf9161dk/nrf9161/ns
    integration_platforms:
      - native_sim
      - native_sim/native
      - native_sim/native/64
      - nrf9161dk/nrf9161/ns
    harness: ztest
    harness_config:
      type: one_line
    timeout: 3000
```

## lib/dect_nrplus/tests/cvg_security/testcase.yaml
```yaml
tests:
  testing.dect_nrplus.cvg_security.crypto:
    tags: dect_nrplus cvg security
    harness: ztest
    platform_allow:
      - nrf9151dk/nrf9151/ns
      - nrf9161dk/nrf9161/ns
    integration_platforms:
      - nrf9151dk
      - nrf9161dk
    timeout: 20
```

## lib/dect_nrplus/tests/l2_6lowpan/testcase.yaml
```yaml
tests:
  dect_stack.integration.cvg_to_cvg:
    tags: dect_nrplus stack_integration
    platform_allow: native_sim
    integration_platforms:
      - native_sim
    harness: ztest
    harness_config:
      type: one_line
    timeout: 300
```

## lib/dect_nrplus/tests/mac_ass_security/testcase.yaml
```yaml
tests:
  testing.dect_nrplus.mac_ass.security:
    tags: dect_nrplus mac security
    platform_allow: 
      # - native_sim
      # - native_sim/native
      # - native_sim/native/64
      - nrf9151dk/nrf9151/ns
      - nrf9161dk/nrf9161/ns
    integration_platforms:
      # - native_sim
      # - native_sim/native
      # - native_sim/native/64
      - nrf9151dk
      - nrf9161dk
    harness: ztest
    harness_config:
      type: one_line
```

## lib/dect_nrplus/tests/mac_error_handling/testcase.yaml
```yaml
tests:
  testing.dect_nrplus.mac.error_handling:
    tags: dect_nrplus mac sm error
    skip: true
    platform_allow: 
      - native_sim
      - native_sim/native
      - native_sim/native/64
      - nrf9161dk/nrf9161/ns
    integration_platforms:
      - native_sim
      - native_sim/native
      - native_sim/native/64
      - nrf9161dk/nrf9161/ns
    harness: ztest
    harness_config:
      type: one_line
    timeout: 3000
```

## lib/dect_nrplus/tests/mac_flow/testcase.yaml
```yaml
tests:
  mac_flow.basic:
    tags: dect_nrlus
    platform_allow: 
      - native_sim
      - native_sim/native
      - native_sim/native/64
      - nrf9161dk/nrf9161/ns
    integration_platforms:
      - native_sim
      - native_sim/native
      - native_sim/native/64
      - nrf9161dk/nrf9161/ns
    harness: ztest
    harness_config:
      type: one_line
    timeout: 300
```

## lib/dect_nrplus/tests/mac_ft_beacon/testcase.yaml
```yaml
# tests/mac_ft_beacon/testcase.yaml
tests:
  testing.dect_nrplus.mac_ft_beacon.basic:
    tags: dect_nrplus mac ft
    platform_allow: 
      - native_sim
      - native_sim/native
      - native_sim/native/64
      - nrf9161dk/nrf9161/ns
    integration_platforms:
      - native_sim
      - native_sim/native
      - native_sim/native/64
      - nrf9161dk/nrf9161/ns
    harness: ztest
    harness_config:
      type: one_line
    timeout: 3000
```

## lib/dect_nrplus/tests/mac_mobility/testcase.yaml
```yaml
# /* lib/dect_nrplus/tests/mac_mobility/testcase.yaml */
tests:
  mac_mobility.handover:
    tags: dect_nrplus mac mobility
    platform_allow: 
      - native_sim
      - native_sim/native
      - native_sim/native/64
      - nrf9161dk/nrf9161/ns
    integration_platforms:
      - native_sim
      - native_sim/native
      - native_sim/native/64
      - nrf9161dk/nrf9161/ns
    harness: ztest
    harness_config:
      type: one_line
    timeout: 300
```

## lib/dect_nrplus/tests/mac_pdu/testcase.yaml
```yaml
tests:
  mac_pdu.serialization:
    tags: dect_nrplus mac pdu
    harness: ztest
    platform_allow: 
      - native_sim
      - native_sim/native
      - native_sim/native/64
    integration_platforms:
      - native_sim
      - native_sim/native
      - native_sim/native/64
    timeout: 15

    
```

## lib/dect_nrplus/tests/mac_phy_ctrl/testcase.yaml
```yaml
tests:
  mac_phy_ctrl.tbs:
    tags: dect_nrplus
    platform_allow: 
      - native_sim
      - native_sim/native
      - native_sim/native/64
      - nrf9161dk/nrf9161/ns
    integration_platforms:
      - native_sim
      - native_sim/native
      - native_sim/native/64
      - nrf9161dk/nrf9161/ns
    harness: ztest
    harness_config:
      type: one_line
    timeout: 300
```

## lib/dect_nrplus/tests/mac_security/testcase.yaml
```yaml
tests:
  testing.dect_nrplus.mac_security.crypto:
    tags: dect_nrplus mac security
    harness: ztest
    platform_allow:
      - nrf9151dk/nrf9151/ns
      - nrf9161dk/nrf9161/ns
    integration_platforms:
      - nrf9151dk
      - nrf9161dk
    timeout: 20
```
