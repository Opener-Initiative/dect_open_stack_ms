## drivers/net/dect_nrplus/Kconfig.dect_nrplus
```kconfig
if NET_L2_DECT_NRPLUS

config DECT_NRPLUS_RX_THREAD_STACK_SIZE
	int "DECT NR+ L2 driver RX thread stack size"
	default 2048
	help
	  Stack size for the DECT NR+ L2 driver's RX thread. This thread
	  receives data from the CVG layer and passes it up to the IP stack.
	  
config DECT_NRPLUS_LOG_LEVEL
	int "DECT NR+ L2 driver log level"
	default 3
	range 0 4
	depends on NET_LOG
	help
	  Log level for the DECT NR+ L2 network driver.
	  0=off, 1=error, 2=warning, 3=info, 4=debug


# Option for 6LoWPAN integration over DECT NR+
config NET_L2_6LO_DECT_NRPLUS
	bool "6LoWPAN over DECT NR+"
	depends on NET_L2_6LO && NET_IPV6 # 6LoWPAN requires IPv6
	select NET_L2_SIXLoWPAN # Selects the generic 6LoWPAN L2 component
	help
		Enable 6LoWPAN adaptation layer to run on top of the DECT NR+ L2 driver.
		This allows IPv6 packets to be compressed and fragmented for transmission
		over the DECT NR+ link. The DECT NR+ L2 driver will then interact with
		the CVG layer.

endif # NET_L2_DECT_NRPLUS
```

## dts/bindings/net/dect-nrplus.yaml
```yaml
description: Nordic DECT NR+ L2 Network Driver

compatible: "nordic,dect-nrplus"

include: net-if-base.yaml
properties:
  cvg-service-type:
    type: int
    required: false
    default: 1
    description: |
      The DECT CVG service type to use for IP traffic.
      0 = Transparent
      1 = Sequenced
      (Other services like ARQ/FC can be added later)
```

## lib/dect_nrplus/Kconfig
```kconfig
# lib/dect_nrplus/Kconfig
#
# Copyright (c) 2024 Manulytica Ltd
#
# SPDX-License-Identifier: Apache-2.0

# This is the main Kconfig file for the dect_nrplus_driver library.
# It is automatically sourced by the Zephyr build system because it is
# named 'Kconfig' and resides in the same directory as the library's
# CMakeLists.txt that calls zephyr_library().

# Source the main menu and options for the DECT NR+ stack.
source "../nrf/lib/dect_nrplus/Kconfig.dect_module"
source "../nrf/lib/dect_nrplus/Kconfig.dect_nrplus"
```

## lib/dect_nrplus/Kconfig.dect_cdd
```kconfig
# /* lib/dect_nrplus/Kconfig.dect_cdd */
# // Overview: Creates the missing Kconfig file for the CDD service. This defines the DECT_CDD_LAYER symbol, resolving the build warning.
# Copyright (c) 2024 Manulytica Ltd
# SPDX-License-Identifier: LicenseRef-Nordic-5-Clause

menuconfig DECT_CDD_LAYER
	bool "DECT NR+ CDD Service Support"
	default y if DECT_CVG_LAYER
	depends on DECT_CVG_LAYER || ZTEST
	help
	  Enable the DECT NR+ Configuration Data Distribution (CDD) service.
	  This layer is responsible for distributing network configuration,
	  such as IPv6 prefixes, as per ETSI TS 103 636-5, Annex C.
	  It is used by the CVG layer for IPv6 profile support.

if DECT_CDD_LAYER

config DECT_CDD_LOG_LEVEL
	int "DECT NR+ CDD service log level"
	default 3
	range 0 4
	depends on LOG
	help
	  Log level for the DECT NR+ CDD service.

endif # DECT_CDD_LAYER
```

## lib/dect_nrplus/Kconfig.dect_cvg
```kconfig
# /* lib/dect_nrplus/Kconfig.dect_cvg */ 
# Copyright (c) 2023 Nordic Semiconductor ASA
# SPDX-License-Identifier: LicenseRef-Nordic-5-Clause

menuconfig DECT_CVG_LAYER
	bool "DECT NR+ CVG Layer Support"
	default n
	default y if DECT_DLC_LAYER
	# depends on DECT_DLC_LAYER || ZTEST
	# help
	#   Enable the DECT NR+ Convergence (CVG) layer.
	#   This layer is responsible for end-to-end services like
	#   segmentation/reassembly, flow control, and ARQ.
	#   It sits between the application/L2 and the DLC layer.

# if DECT_CVG_LAYER

config DECT_CVG_SECURITY_ENABLE
	bool "Enable CVG Layer Security (Mode 1)"
	default y if DECT_MAC_SECURITY_ENABLE
	depends on DECT_MAC_SECURITY_ENABLE
	select TIMING_FUNCTIONS if DECT_MAC_SECURITY_ENABLE
	help
	  Enables CVG layer security features like payload encryption and
	  integrity protection. This depends on the MAC layer security being
	  enabled to provide the keying material. It selects dependencies
	  like TIMING_FUNCTIONS needed for crypto operations.

config DECT_STACK_HAS_APP_THREADS
	bool "DECT stack is used with an application that requires data threads"
	default y
	help
	  This should be enabled for a full application build where the CVG/DLC
	  RX/TX threads are needed to ferry data to/from the application layer.
	  For unit tests that only verify the MAC layer, this can be disabled
	  to prevent the threads from starting and causing deadlocks.

config DECT_CVG_TX_THREAD_STACK_SIZE
	int "CVG TX thread stack size"
	default 2048
	# help
	#   Stack size for the CVG layer's TX thread. This thread
	#   takes data from the application, builds CVG PDUs, and
	#   passes them to the DLC layer.

config DECT_CVG_TX_THREAD_PRIORITY
	int "CVG TX thread priority"
	default 5
	# help
	#   Priority for the CVG TX thread.

config DECT_CVG_RX_THREAD_STACK_SIZE
	int "CVG RX thread stack size"
	default 2048
	# help
	#   Stack size for the CVG layer's RX thread. This thread
	#   receives data from the DLC layer, performs reassembly,
	#   and passes complete SDUs up to the application.

config DECT_CVG_RX_THREAD_PRIORITY
	int "CVG RX thread priority"
	default 5
	# help
	#   Priority for the CVG RX thread.

config DECT_CVG_TX_SERVICE_THREAD_STACK_SIZE
	int "CVG TX service thread stack size"
	default 2048
	# help
	#   Stack size for the CVG layer's TX service thread, which
	#   handles background tasks like ARQ retransmissions.

config DECT_CVG_TX_SERVICE_THREAD_PRIORITY
	int "CVG TX service thread priority"
	default 5
	# help
	#   Priority for the CVG TX service thread.

config DECT_CVG_LOG_LEVEL
	int "DECT NR+ CVG layer log level"
	default 3
	range 0 4
	depends on LOG
	# help
	#   Log level for the DECT NR+ CVG layer.

# endif # DECT_CVG_LAYER
```

## lib/dect_nrplus/Kconfig.dect_dlc
```kconfig
# /* lib/dect_nrplus/Kconfig.dect_dlc */
# Copyright (c) 2023 Nordic Semiconductor ASA
# SPDX-License-Identifier: LicenseRef-Nordic-5-Clause

menuconfig DECT_DLC_LAYER
	bool "DECT NR+ DLC Layer Support"
	default n
	select NET_BUF
	select DECT_MAC_LAYER
	# default y if DECT_MAC_LAYER
	# depends on DECT_MAC_LAYER || ZTEST
	help
	  Enable the DECT NR+ Data Link Control (DLC) layer.
	  This layer is responsible for routing, segmentation, and reassembly
	  of data packets as per ETSI TS 103 636-5. It sits between the
	  CVG layer and the MAC layer.
	  Uses Zephyr net_buf pools for zero-copy data transfer. Requires
	  CONFIG_NET_BUF_USER_DATA_SIZE >= 16 to hold dect_buf_meta_t.

# if DECT_DLC_LAYER

config DECT_DLC_RX_THREAD_STACK_SIZE
	int "DLC RX thread stack size"
	default 2048
	help
	  Stack size for the DLC layer's RX thread. This thread
	  receives data from the MAC layer, performs reassembly,
	  and passes complete SDUs up to the CVG layer.

config DECT_DLC_RX_THREAD_PRIORITY
	int "DLC RX thread priority"
	default 5
	help
	  Priority for the DLC RX thread.

config DECT_DLC_TX_SERVICE_THREAD_STACK_SIZE
	int "DLC TX service thread stack size"
	default 2048
	help
	  Stack size for the DLC layer's TX service thread. This thread
	  handles background tasks like ARQ retransmissions.

config DECT_DLC_TX_SERVICE_THREAD_PRIORITY
	int "DLC TX service thread priority"
	default 5
	help
	  Priority for the DLC TX service thread.

config DECT_DLC_MAX_SDU_PAYLOAD_SIZE
	int "Maximum DLC SDU payload size (CVG PDU)"
	default 1500 
	# Sized for a standard IP MTU
	help
	  Maximum size of a Service Data Unit (SDU) that the DLC layer
	  can accept from the CVG layer. This defines the upper limit
	  for a single logical packet before DLC segmentation.

config DECT_DLC_LOG_LEVEL
	int "DECT NR+ DLC layer log level"
	default 3
	range 0 4
	depends on LOG
	help
	  Log level for the DECT NR+ DLC layer.

config DECT_DLC_DEFAULT_SDU_LIFETIME_MS
	int "Default DLC SDU Lifetime (ms)"
	default 5000
	help
	  Default lifetime for a DLC SDU in milliseconds. This is used for both
	  the retransmission buffer (ARQ) and the reassembly buffer (SAR).
	  If an SDU is not fully transmitted or reassembled within this time,
	  it will be discarded. This value can be reconfigured over-the-air
	  via the DLC Timers Configuration Control IE.


# --- P1.9: net_buf Data Pool Configuration ---

config DECT_DLC_NET_BUF_FRAG_SIZE
	int "DLC net_buf fragment size (bytes)"
	default 256
	range 128 1640
	help
	  Size of each net_buf fragment in the shared DLC/CVG pool.
	  256 bytes covers a single-slot DECT PDU. Larger SDUs are chained.

config DECT_DLC_NET_BUF_COUNT
	int "DLC net_buf pool total fragment count"
	default 48
	range 16 256
	help
	  Total fragments in the DLC+CVG data pool.
	  RAM = NET_BUF_COUNT * NET_BUF_FRAG_SIZE. Default: 48*256 = 12 KB.

config NET_BUF_USER_DATA_SIZE
	int "DLC net_buf data size"
	default 16
	range 16 256
	help
	  Size of the user data field in each net_buf fragment.


if ZTEST

config DECT_DLC_API_MOCK
	bool "Enable mock API for the DLC layer"
	default n
	help
	  FOR TEST USE ONLY.
	  When enabled, the dlc_send_data() and dlc_receive_data() functions
	  will call through function pointers that can be replaced at runtime
	  by a test spy. This allows unit tests for upper layers (like CVG)
	  to intercept and inject data to/from the DLC layer.

endif # ZTEST



# endif # DECT_DLC_LAYER
```
